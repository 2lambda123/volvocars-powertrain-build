/* VcAesTrboM */
/begin CHARACTERISTIC cVcAesTrboM_B_EngProtnTrboPPeakUseAbsolutP "Use absolute pressure in peak monitor" VALUE 0x00000000 /* address: cVcAesTrboM_B_EngProtnTrboPPeakUseAbsolutP */ UBYTE_COL_DIRECT 0 EQ_LSB_1_d 0 1 /end CHARACTERISTIC
/begin CHARACTERISTIC cVcAesTrboM_B_IsObdExeSpm "Defines where is the obd exe flag coming from (1 if coming from SPM)" VALUE 0x00000000 /* address: cVcAesTrboM_B_IsObdExeSpm */ UBYTE_COL_DIRECT 0 EQ_LSB_1_d 0 1 /end CHARACTERISTIC
/begin CHARACTERISTIC cVcAesTrboM_B_PpLkExhFiMPerm "Switch to bypass FiM permission" VALUE 0x00000000 /* address: cVcAesTrboM_B_PpLkExhFiMPerm */ UBYTE_COL_DIRECT 0 EQ_LSB_1_d 0 1 /end CHARACTERISTIC
/begin AXIS_PTS mVcAesTrboM_rt_TrboMonrTgtLim_c "Target turbo pressure ratio limit for low boost, engine speed breakpoints" 0x00000000 NO_INPUT_QUANTITY UWORD_X_INCR_DIRECT 0 EQ_LSB_0_25 10 0 10000 DEPOSIT ABSOLUTE /end AXIS_PTS
/begin AXIS_PTS mVcAesTrboM_rt_TrboMonrTgtLim_r "Target turbo pressure ratio limit for low boost, Trq breakpoints" 0x00000000 NO_INPUT_QUANTITY SWORD_X_INCR_DIRECT 0 EQ_LSB_0_015625 10 -500 500 DEPOSIT ABSOLUTE /end AXIS_PTS
/begin AXIS_PTS tVcAesTrboM_n_EngSpdMinLim_x "Pressure upstream turbo compressor breakpoint data " 0x00000000 NO_INPUT_QUANTITY FLOAT32_IEEE_X_INCR_DIRECT 0 EQ_LSB_1_a 4 0 110 DEPOSIT ABSOLUTE /end AXIS_PTS
/begin AXIS_PTS tVcAesTrboM_t_TrboMonrLoBoostTiDly_x "Pressure upstream turbo compressor breakpoint data " 0x00000000 NO_INPUT_QUANTITY FLOAT32_IEEE_X_INCR_DIRECT 0 EQ_LSB_1_a 4 0 110 DEPOSIT ABSOLUTE /end AXIS_PTS
/begin MEASUREMENT rVcAesTrboM_D_TrboVntDpHiTmp "Vnt turbo high error counter value " SBYTE EQ_LSB_1_e 1 0 -128 127 READ_WRITE /begin IF_DATA ASAP1B_ADDRESS KP_BLOB 0x00000000 /end IF_DATA /end MEASUREMENT
/begin MEASUREMENT rVcAesTrboM_D_TrboVntDpLoTmp "Vnt turbo high error counter value " SBYTE EQ_LSB_1_e 1 0 -128 127 READ_WRITE /begin IF_DATA ASAP1B_ADDRESS KP_BLOB 0x00000000 /end IF_DATA /end MEASUREMENT
/begin MEASUREMENT rVcAesTrboM_p_EngProtnTrboPPeakPres "Pressure for BSTPEAK monitor" FLOAT32_IEEE EQ_LSB_1_a 1 0 -3.4028234663852886e38 3.4028234663852886e38 READ_WRITE /begin IF_DATA ASAP1B_ADDRESS KP_BLOB 0x00000000 /end IF_DATA /end MEASUREMENT
/begin COMPU_METHOD EQ_LSB_0_000244140625 "" RAT_FUNC "%15.12" "-" COEFFS 0 1 0 0 0 0.000244140625 /end COMPU_METHOD
/begin COMPU_METHOD EQ_LSB_0_015625 "" RAT_FUNC "%10.6" "Nm" COEFFS 0 1 0 0 0 0.015625 /end COMPU_METHOD
/begin COMPU_METHOD EQ_LSB_0_25 "" RAT_FUNC "%8.2" "rpm" COEFFS 0 1 0 0 0 0.25 /end COMPU_METHOD
/begin COMPU_METHOD EQ_LSB_1 "" RAT_FUNC "%12.6" "s" COEFFS 0 1 0 0 0 1 /end COMPU_METHOD
/begin COMPU_METHOD EQ_LSB_1_a "" RAT_FUNC "%12.6" "kPa" COEFFS 0 1 0 0 0 1 /end COMPU_METHOD
/begin COMPU_METHOD EQ_LSB_1_b "" RAT_FUNC "%12.6" "rpm" COEFFS 0 1 0 0 0 1 /end COMPU_METHOD
/begin COMPU_METHOD EQ_LSB_1_c "" RAT_FUNC "%12.6" "-" COEFFS 0 1 0 0 0 1 /end COMPU_METHOD
/begin COMPU_METHOD EQ_LSB_1_d "" RAT_FUNC "%1.0" "-" COEFFS 0 1 0 0 0 1 /end COMPU_METHOD
/begin COMPU_METHOD EQ_LSB_1_e "" RAT_FUNC "%3.0" "-" COEFFS 0 1 0 0 0 1 /end COMPU_METHOD
/begin COMPU_METHOD EQ_LSB_1_f "" RAT_FUNC "%3.0" "deg C" COEFFS 0 1 0 0 0 1 /end COMPU_METHOD
/begin COMPU_METHOD EQ_LSB_1_g "" RAT_FUNC "%3.0" "s" COEFFS 0 1 0 0 0 1 /end COMPU_METHOD
/begin COMPU_METHOD EQ_LSB_1_j "" RAT_FUNC "%1.0" "deg C" COEFFS 0 1 0 0 0 1 /end COMPU_METHOD
/begin COMPU_METHOD EQ_LSB_1_k "" RAT_FUNC "%12.6" "deg C" COEFFS 0 1 0 0 0 1 /end COMPU_METHOD
/begin COMPU_METHOD EQ_LSB_1_l "" RAT_FUNC "%1.0" "s" COEFFS 0 1 0 0 0 1 /end COMPU_METHOD
/begin COMPU_METHOD EQ_LSB_1_m "" RAT_FUNC "%12.6" "kPa/s" COEFFS 0 1 0 0 0 1 /end COMPU_METHOD
/begin COMPU_METHOD EQ_LSB_1_n "" RAT_FUNC "%12.6" "g/s2" COEFFS 0 1 0 0 0 1 /end COMPU_METHOD
/begin COMPU_METHOD VOID_SCALING "Void scaling for unscaled variables" RAT_FUNC "%1.0" "" COEFFS 0 1 0 0 0 1 /end COMPU_METHOD
/begin COMPU_METHOD VOID_SCALING_h "Void scaling for unscaled variables" RAT_FUNC "%12.6" "" COEFFS 0 1 0 0 0 1 /end COMPU_METHOD
/begin FUNCTION SAesTrboM101_FaultFree "" /begin DEF_CHARACTERISTIC cVcAesTrboM_p_TrboMonrLoErrLim /end DEF_CHARACTERISTIC /begin LOC_MEASUREMENT rVcAesTrboM_p_TrboMonrLoTstVal /end LOC_MEASUREMENT /end FUNCTION
/begin FUNCTION SAesTrboM102_WithFault ""
 /begin DEF_CHARACTERISTIC cVcAesTrboM_p_TrboMonrLoErrLim cVcAesTrboM_p_TrboMonrLoErrRnkMax /end DEF_CHARACTERISTIC
 /begin LOC_MEASUREMENT rVcAesTrboM_p_TrboMonrLoTstVal /end LOC_MEASUREMENT
/end FUNCTION
/begin FUNCTION SAesTrboM103_1431_CoreLPHiBoost ""
 /begin DEF_CHARACTERISTIC cVcAesTrboM_p_TrboMonrLPHiErrLim cVcAesTrboM_p_TrboMonrLPHiErrRnkMax /end DEF_CHARACTERISTIC
 /begin LOC_MEASUREMENT rVcAesTrboM_Z_TrboMonrLPHiBoostRnkVal rVcAesTrboM_p_TrboMonrLPHiTstVal xVcAesTrboM_B_TrboMonrLPHiErr xVcAesTrboM_B_TrboMonrLPHiNrm xVcAesTrboM_B_TrboMonrLPHiFalt /end LOC_MEASUREMENT
 /begin SUB_FUNCTION SAesTrboM123_P__rtional_Ranking /end SUB_FUNCTION
/end FUNCTION
/begin FUNCTION SAesTrboM104_1432_CoreHPHiBoost ""
 /begin DEF_CHARACTERISTIC cVcAesTrboM_p_TrboMonrHPHiErrLim cVcAesTrboM_p_TrboMonrHPHiErrRnkMax /end DEF_CHARACTERISTIC
 /begin LOC_MEASUREMENT rVcAesTrboM_Z_TrboMonrHPHiBoostRnkVal rVcAesTrboM_p_TrboMonrHPHiTstVal xVcAesTrboM_B_TrboMonrHPHiErr xVcAesTrboM_B_TrboMonrHPHiNrm xVcAesTrboM_B_TrboMonrHPHiFalt /end LOC_MEASUREMENT
 /begin SUB_FUNCTION SAesTrboM133_P__rtional_Ranking /end SUB_FUNCTION
/end FUNCTION
/begin FUNCTION SAesTrboM105_1433_CoreLPLoBoost ""
 /begin DEF_CHARACTERISTIC cVcAesTrboM_p_TrboMonrLPLoErrLim cVcAesTrboM_p_TrboMonrLPLoErrRnkMax /end DEF_CHARACTERISTIC
 /begin LOC_MEASUREMENT rVcAesTrboM_Z_TrboMonrLPLoBoostRnkVal rVcAesTrboM_p_TrboMonrLPLoTstVal xVcAesTrboM_B_TrboMonrLPLoErr xVcAesTrboM_B_TrboMonrLPLoNrm xVcAesTrboM_B_TrboMonrLPLoFalt /end LOC_MEASUREMENT
 /begin SUB_FUNCTION SAesTrboM143_P__rtional_Ranking /end SUB_FUNCTION
/end FUNCTION
/begin FUNCTION SAesTrboM106_1434_CoreHPLoBoost ""
 /begin DEF_CHARACTERISTIC cVcAesTrboM_p_TrboMonrHPLoErrLim cVcAesTrboM_p_TrboMonrHPLoErrRnkMax /end DEF_CHARACTERISTIC
 /begin LOC_MEASUREMENT rVcAesTrboM_Z_TrboMonrHPLoBoostRnkVal rVcAesTrboM_p_TrboMonrHPLoTstVal xVcAesTrboM_B_TrboMonrHPLoErr xVcAesTrboM_B_TrboMonrHPLoNrm xVcAesTrboM_B_TrboMonrHPLoFalt /end LOC_MEASUREMENT
 /begin SUB_FUNCTION SAesTrboM153_P__rtional_Ranking /end SUB_FUNCTION
/end FUNCTION
/begin FUNCTION SAesTrboM123_P__rtional_Ranking ""
 /begin DEF_CHARACTERISTIC cVcAesTrboM_p_TrboMonrLPHiErrLim cVcAesTrboM_p_TrboMonrLPHiErrRnkMax /end DEF_CHARACTERISTIC
 /begin LOC_MEASUREMENT xVcAesTrboM_B_TrboMonrLPHiErr rVcAesTrboM_p_TrboMonrLPHiTstVal /end LOC_MEASUREMENT
 /begin SUB_FUNCTION SAesTrboM128_WithFault SAesTrboM127_FaultFree /end SUB_FUNCTION
/end FUNCTION
/begin FUNCTION SAesTrboM127_FaultFree "" /begin DEF_CHARACTERISTIC cVcAesTrboM_p_TrboMonrLPHiErrLim /end DEF_CHARACTERISTIC /begin LOC_MEASUREMENT rVcAesTrboM_p_TrboMonrLPHiTstVal /end LOC_MEASUREMENT /end FUNCTION
/begin FUNCTION SAesTrboM128_WithFault ""
 /begin DEF_CHARACTERISTIC cVcAesTrboM_p_TrboMonrLPHiErrLim cVcAesTrboM_p_TrboMonrLPHiErrRnkMax /end DEF_CHARACTERISTIC
 /begin LOC_MEASUREMENT rVcAesTrboM_p_TrboMonrLPHiTstVal /end LOC_MEASUREMENT
/end FUNCTION
/begin FUNCTION SAesTrboM133_P__rtional_Ranking ""
 /begin DEF_CHARACTERISTIC cVcAesTrboM_p_TrboMonrHPHiErrLim cVcAesTrboM_p_TrboMonrHPHiErrRnkMax /end DEF_CHARACTERISTIC
 /begin LOC_MEASUREMENT xVcAesTrboM_B_TrboMonrHPHiErr rVcAesTrboM_p_TrboMonrHPHiTstVal /end LOC_MEASUREMENT
 /begin SUB_FUNCTION SAesTrboM138_WithFault SAesTrboM137_FaultFree /end SUB_FUNCTION
/end FUNCTION
/begin FUNCTION SAesTrboM137_FaultFree "" /begin DEF_CHARACTERISTIC cVcAesTrboM_p_TrboMonrHPHiErrLim /end DEF_CHARACTERISTIC /begin LOC_MEASUREMENT rVcAesTrboM_p_TrboMonrHPHiTstVal /end LOC_MEASUREMENT /end FUNCTION
/begin FUNCTION SAesTrboM138_WithFault ""
 /begin DEF_CHARACTERISTIC cVcAesTrboM_p_TrboMonrHPHiErrLim cVcAesTrboM_p_TrboMonrHPHiErrRnkMax /end DEF_CHARACTERISTIC
 /begin LOC_MEASUREMENT rVcAesTrboM_p_TrboMonrHPHiTstVal /end LOC_MEASUREMENT
/end FUNCTION
/begin FUNCTION SAesTrboM143_P__rtional_Ranking ""
 /begin DEF_CHARACTERISTIC cVcAesTrboM_p_TrboMonrLPLoErrLim cVcAesTrboM_p_TrboMonrLPLoErrRnkMax /end DEF_CHARACTERISTIC
 /begin LOC_MEASUREMENT xVcAesTrboM_B_TrboMonrLPLoErr rVcAesTrboM_p_TrboMonrLPLoTstVal /end LOC_MEASUREMENT
 /begin SUB_FUNCTION SAesTrboM148_WithFault SAesTrboM147_FaultFree /end SUB_FUNCTION
/end FUNCTION
/begin FUNCTION SAesTrboM147_FaultFree "" /begin DEF_CHARACTERISTIC cVcAesTrboM_p_TrboMonrLPLoErrLim /end DEF_CHARACTERISTIC /begin LOC_MEASUREMENT rVcAesTrboM_p_TrboMonrLPLoTstVal /end LOC_MEASUREMENT /end FUNCTION
/begin FUNCTION SAesTrboM148_WithFault ""
 /begin DEF_CHARACTERISTIC cVcAesTrboM_p_TrboMonrLPLoErrLim cVcAesTrboM_p_TrboMonrLPLoErrRnkMax /end DEF_CHARACTERISTIC
 /begin LOC_MEASUREMENT rVcAesTrboM_p_TrboMonrLPLoTstVal /end LOC_MEASUREMENT
/end FUNCTION
/begin FUNCTION SAesTrboM153_P__rtional_Ranking ""
 /begin DEF_CHARACTERISTIC cVcAesTrboM_p_TrboMonrHPLoErrLim cVcAesTrboM_p_TrboMonrHPLoErrRnkMax /end DEF_CHARACTERISTIC
 /begin LOC_MEASUREMENT xVcAesTrboM_B_TrboMonrHPLoErr rVcAesTrboM_p_TrboMonrHPLoTstVal /end LOC_MEASUREMENT
 /begin SUB_FUNCTION SAesTrboM158_WithFault SAesTrboM157_FaultFree /end SUB_FUNCTION
/end FUNCTION
/begin FUNCTION SAesTrboM157_FaultFree "" /begin DEF_CHARACTERISTIC cVcAesTrboM_p_TrboMonrHPLoErrLim /end DEF_CHARACTERISTIC /begin LOC_MEASUREMENT rVcAesTrboM_p_TrboMonrHPLoTstVal /end LOC_MEASUREMENT /end FUNCTION
/begin FUNCTION SAesTrboM158_WithFault ""
 /begin DEF_CHARACTERISTIC cVcAesTrboM_p_TrboMonrHPLoErrLim cVcAesTrboM_p_TrboMonrHPLoErrRnkMax /end DEF_CHARACTERISTIC
 /begin LOC_MEASUREMENT rVcAesTrboM_p_TrboMonrHPLoTstVal /end LOC_MEASUREMENT
/end FUNCTION
/begin FUNCTION SAesTrboM159_21_PPeakTest ""
 /begin DEF_CHARACTERISTIC cVcAesTrboM_B_EngProtnTrboPPeakUseAbsolutP cVcAesTrboM_p_EngProtnTrboPPeakErrLim cVcAesTrboM_p_EngProtnTrboPPeakHealLim cVcAesTrboM_p_EngProtnTrboPPeakRnkMax cVcAesTrboM_p_EngProtnTrboPPeakRnkMin cVcAesTrboM_t_EngProtnTrboPeakErrDly cVcAesTrboM_t_EngProtnTrboPeakHealDly /end DEF_CHARACTERISTIC
 /begin LOC_MEASUREMENT rVcAesTrboM_Z_EngProtnTrboPPeakRnk xVcAesTrboM_B_ObdExe yVcAesTrboM_B_EngProtnTrboPPeakErr rVcAesTrboM_p_EngProtnTrboPPeakPres /end LOC_MEASUREMENT
 /begin SUB_FUNCTION SAesTrboM172_Vc_SetRanking SAesTrboM168_P__rtional_Ranking /end SUB_FUNCTION
/end FUNCTION
/begin FUNCTION SAesTrboM168_P__rtional_Ranking ""
 /begin DEF_CHARACTERISTIC cVcAesTrboM_p_EngProtnTrboPPeakErrLim cVcAesTrboM_p_EngProtnTrboPPeakRnkMax cVcAesTrboM_p_EngProtnTrboPPeakRnkMin /end DEF_CHARACTERISTIC
 /begin LOC_MEASUREMENT yVcAesTrboM_B_EngProtnTrboPPeakErr rVcAesTrboM_p_EngProtnTrboPPeakPres /end LOC_MEASUREMENT
 /begin SUB_FUNCTION SAesTrboM174_WithFault SAesTrboM173_FaultFree /end SUB_FUNCTION
/end FUNCTION
/begin FUNCTION SAesTrboM172_Vc_SetRanking "" /begin LOC_MEASUREMENT rVcAesTrboM_Z_EngProtnTrboPPeakRnk /end LOC_MEASUREMENT /end FUNCTION
/begin FUNCTION SAesTrboM173_FaultFree ""
 /begin DEF_CHARACTERISTIC cVcAesTrboM_p_EngProtnTrboPPeakErrLim cVcAesTrboM_p_EngProtnTrboPPeakRnkMin /end DEF_CHARACTERISTIC
 /begin LOC_MEASUREMENT rVcAesTrboM_p_EngProtnTrboPPeakPres /end LOC_MEASUREMENT
/end FUNCTION
/begin FUNCTION SAesTrboM174_WithFault ""
 /begin DEF_CHARACTERISTIC cVcAesTrboM_p_EngProtnTrboPPeakErrLim cVcAesTrboM_p_EngProtnTrboPPeakRnkMax /end DEF_CHARACTERISTIC
 /begin LOC_MEASUREMENT rVcAesTrboM_p_EngProtnTrboPPeakPres /end LOC_MEASUREMENT
/end FUNCTION
/begin FUNCTION SAesTrboM175_31_StuckTest ""
 /begin DEF_CHARACTERISTIC cVcAesTrboM_B_PpValveStuckNoPump cVcAesTrboM_p_PpValveStuck cVcAesTrboM_t_PpValveStuckErrDly cVcAesTrboM_t_PpValveStuckHealDly cVcAesTrboM_t_PpValveStuckOkDly cVcAesTrboM_p_PpValveStuckMinPres cVcAesTrboM_t_PpValveStuckRefResetDly /end DEF_CHARACTERISTIC
 /begin LOC_MEASUREMENT xVcAesTrboM_B_ObdExe xVcAesTrboM_B_PpValveStkExe xVcAesTrboM_B_PpValveStuckUnfiltErr xVcAesTrboM_B_PpValveStuckOkExe xVcAesTrboM_B_PpValveStuckErr rVcAesTrboM_p_PpValveStuckPDiff rVcAesTrboM_p_PpValveStuckPDiffMax xVcAesTrboM_B_PpValveStuckEnable /end LOC_MEASUREMENT
/end FUNCTION
/begin FUNCTION SAesTrboM19_111_PressureRt ""
 /begin DEF_CHARACTERISTIC mVcAesTrboM_rt_TrboMonrTgtLim mVcAesTrboM_rt_TrboMonrTgtLim_r mVcAesTrboM_rt_TrboMonrTgtLim_c /end DEF_CHARACTERISTIC
 /begin LOC_MEASUREMENT rVcAesTrboM_rt_TrboMonrTgtTqNLim rVcAesTrboM_p_TrboMonrCacPTrjLimDif rVcAesTrboM_p_TrboMonrCacPTrjDif rVcAesTrboM_rt_TrboMonrTgtLim rVcAesTrboM_rt_TrboMonrSnsr rVcAesTrboM_rt_TrboMonrTgt /end LOC_MEASUREMENT
/end FUNCTION
/begin FUNCTION SAesTrboM191_41_LeakTest ""
 /begin DEF_CHARACTERISTIC cVcAesTrboM_B_PpLkUseMaxtimeout cVcAesTrboM_p_PpLkLim cVcAesTrboM_t_PpLeakPlsDly cVcAesTrboM_t_PpLeakTimeOut cVcAesTrboM_t_PpLkErrDly cVcAesTrboM_t_PpLkHealDly cVcAesTrboM_t_PpLkOkDly cVcAesTrboM_t_PpLkPumpReqTimeOut /end DEF_CHARACTERISTIC
 /begin LOC_MEASUREMENT xVcAesTrboM_B_ObdExe xVcAesTrboM_B_PpLkPumpAct xVcAesTrboM_B_PpLkExe xVcAesTrboM_B_PpLkFltFlagUnfiltd xVcAesTrboM_B_PpLkOk rVcAesTrboM_p_PpLkTstValue xVcAesTrboM_B_PpLkMaxPumpReqTimeOut xVcAesTrboM_B_PpLkErr xVcAesTrboM_B_PpLkFltFlag xVcAesTrboM_B_PpLkPumpActDly rVcAesTrboM_p_PpLkInitPres /end LOC_MEASUREMENT
/end FUNCTION
/begin FUNCTION SAesTrboM192_42_LeakExhTest ""
 /begin DEF_CHARACTERISTIC cVcAesTrboM_B_PpLkExhNoPumpUse cVcAesTrboM_p_PpLkExhLim cVcAesTrboM_t_PpLkExhAftStrt cVcAesTrboM_t_PpLkExhErrDly cVcAesTrboM_t_PpLkExhHealDly cVcAesTrboM_t_PpLkExhOkDly /end DEF_CHARACTERISTIC
 /begin LOC_MEASUREMENT xVcAesTrboM_B_ObdExe xVcAesTrboM_B_PpLkExhFltFlagUnfiltd xVcAesTrboM_B_PpLkExhExe xVcAesTrboM_B_PpLkExhErr xVcAesTrboM_B_PpLkExhFtlFlag rVcAesTrboM_p_PpLkExhTstValue /end LOC_MEASUREMENT
/end FUNCTION
/begin FUNCTION SAesTrboM215_51_PpSmalLeakTest ""
 /begin DEF_CHARACTERISTIC cVcAesTrboM_B_PpSmLkNotUseCmprOk cVcAesTrboM_Te_PpSmLkMinTempEna cVcAesTrboM_p_PpSmLkMaxDrop cVcAesTrboM_t_PpSmLkErrDly cVcAesTrboM_t_PpSmLkHealDly cVcAesTrboM_t_PpSmLkMaxLastCompRun cVcAesTrboM_t_PpSmLkMinLastCompRun cVcAesTrboM_t_PpSmLkOkDly /end DEF_CHARACTERISTIC
 /begin LOC_MEASUREMENT xVcAesTrboM_B_ObdExe xVcAesTrboM_B_PpSmLkOk xVcAesTrboM_B_PpSmLkFltFlagUnfiltd xVcAesTrboM_B_PpSmLkExe xVcAesTrboM_B_PpSmalLeakExe xVcAesTrboM_B_PpSmLkPreErr rVcAesTrboM_p_PpSmLkTstVal xVcAesTrboM_B_PpSmLkErr xVcAesTrboM_B_PpSmLkFltFlag rVcAesTrboM_p_PpSmLkInitPres rVcAesTrboM_t_PpSmLkCompRun /end LOC_MEASUREMENT
/end FUNCTION
/begin FUNCTION SAesTrboM227_61_RelayStuckTest "" /begin DEF_CHARACTERISTIC cVcAesTrboM_p_Rly1StkLim cVcAesTrboM_p_Rly2StkLim /end DEF_CHARACTERISTIC
 /begin LOC_MEASUREMENT xVcAesTrboM_B_ObdExe xVcAesTrboM_B_Rly2StkRly1Act xVcAesTrboM_B_Rly2StkOk xVcAesTrboM_B_Rly1StkErr xVcAesTrboM_B_Rly2StkExe xVcAesTrboM_B_Rly2StkErr xVcAesTrboM_B_Rly1StkRly2Act xVcAesTrboM_B_Rly1StkOk xVcAesTrboM_B_Rly1StkExe rVcAesTrboM_p_Rly2StkTstValue rVcAesTrboM_p_Rly1StkTstValue rVcAesTrboM_p_Rly2StkInitPres rVcAesTrboM_p_Rly1StkInitPres /end LOC_MEASUREMENT
/end FUNCTION
/begin FUNCTION SAesTrboM249_621_CoreVntDp ""
 /begin DEF_CHARACTERISTIC cVcAesTrboM_B_TrboVntDpRst cVcAesTrboM_D_TrboVntDpHiErrLim cVcAesTrboM_D_TrboVntDpHiNrmLim cVcAesTrboM_D_TrboVntDpHiRstVal cVcAesTrboM_D_TrboVntDpLoErrLim cVcAesTrboM_D_TrboVntDpLoNrmLim cVcAesTrboM_D_TrboVntDpLoRstVal cVcAesTrboM_D_TrboVntStsCntMax cVcAesTrboM_D_TrboVntStsCntMin cVcAesTrboM_D_TrboVntStsNOKHI cVcAesTrboM_D_TrboVntStsNOKInc cVcAesTrboM_D_TrboVntStsNOKLO cVcAesTrboM_D_TrboVntStsOK cVcAesTrboM_D_TrboVntStsOKDec /end DEF_CHARACTERISTIC
 /begin LOC_MEASUREMENT rVcAesTrboM_D_TrboVntDpLoTmp rVcAesTrboM_D_TrboVntDpHiTmp xVcAesTrboM_B_TrboVntDpLoTmpNrm xVcAesTrboM_B_TrboVntDpHiTmpErr xVcAesTrboM_B_TrboVntDpLoTmpErr xVcAesTrboM_B_TrboVntStsLoErr xVcAesTrboM_B_TrboVntStsHiErr xVcAesTrboM_B_TrboVntDpStsLoOk xVcAesTrboM_B_TrboVntDpStsHiOk sVcAesTrboM_D_TrboVntDpStsLoCnt sVcAesTrboM_D_TrboVntDpStsHiCnt /end LOC_MEASUREMENT
 /begin SUB_FUNCTION SAesTrboM264_WriteNVM SAesTrboM261_WriteNVM /end SUB_FUNCTION
/end FUNCTION
/begin FUNCTION SAesTrboM261_WriteNVM "" /begin LOC_MEASUREMENT sVcAesTrboM_D_TrboVntDpStsHiCnt /end LOC_MEASUREMENT /end FUNCTION
/begin FUNCTION SAesTrboM264_WriteNVM "" /begin LOC_MEASUREMENT sVcAesTrboM_D_TrboVntDpStsLoCnt /end LOC_MEASUREMENT /end FUNCTION
/begin FUNCTION SAesTrboM29_123_2T ""
 /begin DEF_CHARACTERISTIC cVcAesTrboM_n_TrboMonrHPEngSpdMax cVcAesTrboM_n_TrboMonrLPEngSpdMin /end DEF_CHARACTERISTIC
 /begin LOC_MEASUREMENT xVcAesTrboM_B_TrboMonrLoExe xVcAesTrboM_B_TrboMonrHiExe xVcAesTrboM_B_TrboMonrHPLoExe xVcAesTrboM_B_TrboMonrLPHiExe xVcAesTrboM_B_TrboMonrHPHiExe xVcAesTrboM_B_TrboMonrLPLoExe /end LOC_MEASUREMENT
/end FUNCTION
/begin FUNCTION SAesTrboM3_1_TrboMonr ""
 /begin DEF_CHARACTERISTIC tVcAesTrboM_t_TrboMonrLoBoostTiDly tVcAesTrboM_t_TrboMonrLoBoostTiDly_x tVcAesTrboM_n_EngSpdMinLim tVcAesTrboM_n_EngSpdMinLim_x cVcAesTrboM_t_TrboMonrHiAvgTi cVcAesTrboM_t_TrboMonrLoAvgTi cVcAesTrboM_B_TrboMonrBypFiMPerm cVcAesTrboM_Te_TrboMonrEngClntMinLim cVcAesTrboM_B_TrboMonrCmprBypCfg cVcAesTrboM_B_TrboMonrCmprPUsCfg cVcAesTrboM_B_TrboMonrLoEOM0 cVcAesTrboM_B_TrboMonrLoEOM1 cVcAesTrboM_B_TrboMonrLoEOM2 cVcAesTrboM_B_TrboMonrLoEOM3 cVcAesTrboM_B_TrboMonrLoEOM4 cVcAesTrboM_B_TrboMonrLoEOM5 cVcAesTrboM_B_TrboMonrLoRegDsbl cVcAesTrboM_B_TrboMonrSCCluCfg cVcAesTrboM_B_TrboMonrTrboActvLoDsbl cVcAesTrboM_Te_TrboMonrLoRegMin cVcAesTrboM_Z_TrboMonrPTrjDFilMaxLim cVcAesTrboM_Z_TrboMonrPTrjDFilMinLim cVcAesTrboM_p_TrboMonrIntkBoostPTrjMinLim cVcAesTrboM_p_TrboMonrSCPMaxLim cVcAesTrboM_t_TrboMonrLoRegDly cVcAesTrboM_t_TrboMonrPTrjStabDly cVcAesTrboM_tc_TrboMonrTiConPTrjDFil cVcAesTrboM_B_TrboMonrHiEOM0 cVcAesTrboM_B_TrboMonrHiEOM1 cVcAesTrboM_B_TrboMonrHiEOM2 cVcAesTrboM_B_TrboMonrHiEOM3 cVcAesTrboM_B_TrboMonrHiEOM4 cVcAesTrboM_B_TrboMonrHiEOM5 cVcAesTrboM_B_TrboMonrHiRegDsbl cVcAesTrboM_B_TrboMonrTrboActvHiDsbl cVcAesTrboM_Te_TrboMonrHiRegMin cVcAesTrboM_Z_TrboMonrHiPTrjDFilMaxLim cVcAesTrboM_Z_TrboMonrHiPTrjDFilMinLim cVcAesTrboM_Z_TrboMonrThrMFlowDMinLim cVcAesTrboM_n_TrboMonrNEngMaxLim cVcAesTrboM_p_TrboMonrAmbPDifMinLim cVcAesTrboM_p_TrboMonrCacPDifMinLim cVcAesTrboM_t_TrboMonrHiPTrjStabDly cVcAesTrboM_t_TrboMonrHiRegDly cVcAesTrboM_tc_TrboMonrHiTiConPTrjDFil cVcAesTrboM_tc_TrboMonrThrMFlowDFil cVcAesTrboM_B_TrboMonrBoostPCfg cVcAesTrboM_B_TrboMonrSCPCfg /end DEF_CHARACTERISTIC
 /begin LOC_MEASUREMENT xVcAesTrboM_B_ObdExe xVcAesTrboM_B_TrboMonrSHiErr xVcAesTrboM_B_TrboMonrSLoErr sVcAesTrboM_p_TrboMonrAmbPDif rVcAesTrboM_p_TrboMonrHiTstVal xVcAesTrboM_B_TrboMonrHiTstValCmplt rVcAesTrboM_p_TrboMonrHPLoTstVal xVcAesTrboM_B_TrboMonrHPLoTstValCmplt rVcAesTrboM_p_TrboMonrLPHiTstVal xVcAesTrboM_B_TrboMonrLPHiTstValCmplt rVcAesTrboM_p_TrboMonrHPHiTstVal xVcAesTrboM_B_TrboMonrHPHiTstValCmplt rVcAesTrboM_p_TrboMonrLoTstVal xVcAesTrboM_B_TrboMonrLoTstValCmplt rVcAesTrboM_p_TrboMonrLPLoTstVal xVcAesTrboM_B_TrboMonrLPLoTstValCmplt xVcAesTrboM_B_TrboMonrHPLoExe rVcAesTrboM_p_TrboMonrCacPTrjDif rVcAesTrboM_p_TrboMonrCacPTrjLimDif xVcAesTrboM_B_TrboMonrHiExe xVcAesTrboM_B_TrboMonrLPLoExe xVcAesTrboM_B_TrboMonrHPHiExe xVcAesTrboM_B_TrboMonrLoExe xVcAesTrboM_B_TrboMonrLPHiExe xVcAesTrboM_B_TrboMonrGetPerm xVcAesTrboM_B_TrboMonrEngClntEna xVcAesTrboM_B_TrboMonrLoPTrjStab xVcAesTrboM_B_TrboMonrLoRegEna xVcAesTrboM_B_TrboMonrLoCmprBypActvEna xVcAesTrboM_B_TrboMonrActvLoEna xVcAesTrboM_B_TrboMonrLoRegActv xVcAesTrboM_B_TrboMonrLoIntkBoostTrjEna xVcAesTrboM_B_TrboMonrLoEngSpdEna rVcAesTrboM_p_TrboMonrIntkBoostPTrjAmbDif rVcAesTrboM_p_TrboMonrSCAmbPDiff rVcAesTrboM_p_TrboMonrPCmprUs xVcAesTrboM_B_TrboMonrLoRegDly xVcAesTrboM_B_TrboMonrPTrjStabEna xVcAesTrboM_B_TrboMonrLoDynEna xVcAesTrboM_B_TrboMonrSCPEna rVcAesTrboM_Z_TrboMonrPTrjDFil xVcAesTrboM_B_TrboMonrHiPTrjStab xVcAesTrboM_B_TrboMonrHiRegActv xVcAesTrboM_B_TrboMonrHiRegEna xVcAesTrboM_B_TrboMonrActvHiEna xVcAesTrboM_B_TrboMonrCacPTrjDifEna xVcAesTrboM_B_TrboMonrThrFlowDEna xVcAesTrboM_B_TrboMonrNEngEna xVcAesTrboM_B_TrboMonrPAmbDiffEna xVcAesTrboM_B_TrboMonrHiRegDly xVcAesTrboM_B_TrboMonrHiPTrjStabEna rVcAesTrboM_Z_TrboThrMFlowDFild rVcAesTrboM_Z_TrboMonrHiPTrjDFil /end LOC_MEASUREMENT
 /begin SUB_FUNCTION SAesTrboM19_111_PressureRt SAesTrboM73_143_2T SAesTrboM72_142_CoreLoBoost SAesTrboM71_141_CoreHiBoost SAesTrboM53_Avg2 SAesTrboM52_Avg1 SAesTrboM51_131_2T SAesTrboM29_123_2T /end SUB_FUNCTION
/end FUNCTION
/begin FUNCTION SAesTrboM4_2_EngProtnTrboPPeak "" /begin DEF_CHARACTERISTIC cVcAesTrboM_B_TrboMonrPPeakBypFiMPerm /end DEF_CHARACTERISTIC /begin LOC_MEASUREMENT xVcAesTrboM_B_ObdExe yVcAesTrboM_B_EngProtnTrboPPeakErr /end LOC_MEASUREMENT /begin SUB_FUNCTION SAesTrboM159_21_PPeakTest /end SUB_FUNCTION /end FUNCTION
/begin FUNCTION SAesTrboM5_3_PPvalveStuckClosed "" /begin LOC_MEASUREMENT xVcAesTrboM_B_ObdExe /end LOC_MEASUREMENT /begin SUB_FUNCTION SAesTrboM175_31_StuckTest /end SUB_FUNCTION /end FUNCTION
/begin FUNCTION SAesTrboM51_131_2T ""
 /begin DEF_CHARACTERISTIC cVcAesTrboM_t_TrboMonrHPHiAvgTi cVcAesTrboM_t_TrboMonrHPLoAvgTi cVcAesTrboM_t_TrboMonrLPHiAvgTi cVcAesTrboM_t_TrboMonrLPLoAvgTi /end DEF_CHARACTERISTIC
 /begin LOC_MEASUREMENT rVcAesTrboM_p_TrboMonrCacPTrjDif xVcAesTrboM_B_TrboMonrLPHiExe xVcAesTrboM_B_TrboMonrHPHiExe rVcAesTrboM_p_TrboMonrCacPTrjLimDif xVcAesTrboM_B_TrboMonrLPLoExe xVcAesTrboM_B_TrboMonrHPLoExe rVcAesTrboM_p_TrboMonrHPLoTstVal xVcAesTrboM_B_TrboMonrHPLoTstValCmplt rVcAesTrboM_p_TrboMonrLPHiTstVal xVcAesTrboM_B_TrboMonrLPHiTstValCmplt rVcAesTrboM_p_TrboMonrHPHiTstVal xVcAesTrboM_B_TrboMonrHPHiTstValCmplt rVcAesTrboM_p_TrboMonrLPLoTstVal xVcAesTrboM_B_TrboMonrLPLoTstValCmplt /end LOC_MEASUREMENT
 /begin SUB_FUNCTION SAesTrboM58_LPLoTstVal SAesTrboM57_LPHiTstVal SAesTrboM56_HPLoTstVal SAesTrboM55_HPHiTstVal /end SUB_FUNCTION
/end FUNCTION
/begin FUNCTION SAesTrboM52_Avg1 "" /begin DEF_CHARACTERISTIC cVcAesTrboM_t_TrboMonrHiAvgTi /end DEF_CHARACTERISTIC
 /begin LOC_MEASUREMENT xVcAesTrboM_B_TrboMonrHiTstValCmplt rVcAesTrboM_p_TrboMonrCacPTrjDif rVcAesTrboM_p_TrboMonrHiTstVal xVcAesTrboM_B_TrboMonrHiExe /end LOC_MEASUREMENT
 /begin SUB_FUNCTION SAesTrboM68_Subsystem SAesTrboM67_EnabledSubsystem /end SUB_FUNCTION
/end FUNCTION
/begin FUNCTION SAesTrboM53_Avg2 "" /begin DEF_CHARACTERISTIC cVcAesTrboM_t_TrboMonrLoAvgTi /end DEF_CHARACTERISTIC
 /begin LOC_MEASUREMENT xVcAesTrboM_B_TrboMonrLoTstValCmplt rVcAesTrboM_p_TrboMonrCacPTrjLimDif rVcAesTrboM_p_TrboMonrLoTstVal xVcAesTrboM_B_TrboMonrLoExe /end LOC_MEASUREMENT
 /begin SUB_FUNCTION SAesTrboM70_Subsystem SAesTrboM69_EnabledSubsystem /end SUB_FUNCTION
/end FUNCTION
/begin FUNCTION SAesTrboM55_HPHiTstVal "" /begin DEF_CHARACTERISTIC cVcAesTrboM_t_TrboMonrHPHiAvgTi /end DEF_CHARACTERISTIC
 /begin LOC_MEASUREMENT xVcAesTrboM_B_TrboMonrHPHiTstValCmplt rVcAesTrboM_p_TrboMonrCacPTrjDif rVcAesTrboM_p_TrboMonrHPHiTstVal xVcAesTrboM_B_TrboMonrHPHiExe /end LOC_MEASUREMENT
 /begin SUB_FUNCTION SAesTrboM60_Subsystem SAesTrboM59_EnabledSubsystem /end SUB_FUNCTION
/end FUNCTION
/begin FUNCTION SAesTrboM56_HPLoTstVal "" /begin DEF_CHARACTERISTIC cVcAesTrboM_t_TrboMonrHPLoAvgTi /end DEF_CHARACTERISTIC
 /begin LOC_MEASUREMENT xVcAesTrboM_B_TrboMonrHPLoTstValCmplt rVcAesTrboM_p_TrboMonrCacPTrjLimDif rVcAesTrboM_p_TrboMonrHPLoTstVal xVcAesTrboM_B_TrboMonrHPLoExe /end LOC_MEASUREMENT
 /begin SUB_FUNCTION SAesTrboM62_Subsystem SAesTrboM61_EnabledSubsystem /end SUB_FUNCTION
/end FUNCTION
/begin FUNCTION SAesTrboM57_LPHiTstVal "" /begin DEF_CHARACTERISTIC cVcAesTrboM_t_TrboMonrLPHiAvgTi /end DEF_CHARACTERISTIC
 /begin LOC_MEASUREMENT xVcAesTrboM_B_TrboMonrLPHiTstValCmplt rVcAesTrboM_p_TrboMonrCacPTrjDif rVcAesTrboM_p_TrboMonrLPHiTstVal xVcAesTrboM_B_TrboMonrLPHiExe /end LOC_MEASUREMENT
 /begin SUB_FUNCTION SAesTrboM64_Subsystem SAesTrboM63_EnabledSubsystem /end SUB_FUNCTION
/end FUNCTION
/begin FUNCTION SAesTrboM58_LPLoTstVal "" /begin DEF_CHARACTERISTIC cVcAesTrboM_t_TrboMonrLPLoAvgTi /end DEF_CHARACTERISTIC
 /begin LOC_MEASUREMENT xVcAesTrboM_B_TrboMonrLPLoTstValCmplt rVcAesTrboM_p_TrboMonrCacPTrjLimDif rVcAesTrboM_p_TrboMonrLPLoTstVal xVcAesTrboM_B_TrboMonrLPLoExe /end LOC_MEASUREMENT
 /begin SUB_FUNCTION SAesTrboM66_Subsystem SAesTrboM65_EnabledSubsystem /end SUB_FUNCTION
/end FUNCTION
/begin FUNCTION SAesTrboM59_EnabledSubsystem "" /begin LOC_MEASUREMENT rVcAesTrboM_p_TrboMonrHPHiTstVal /end LOC_MEASUREMENT /end FUNCTION
/begin FUNCTION SAesTrboM6_4_PpLeakage "" /begin DEF_CHARACTERISTIC cVcAesTrboM_B_PpLkExhFiMPerm cVcAesTrboM_B_PpLkFiMPerm /end DEF_CHARACTERISTIC /begin LOC_MEASUREMENT xVcAesTrboM_B_ObdExe /end LOC_MEASUREMENT /begin SUB_FUNCTION SAesTrboM192_42_LeakExhTest SAesTrboM191_41_LeakTest /end SUB_FUNCTION /end FUNCTION
/begin FUNCTION SAesTrboM60_Subsystem "" /begin DEF_CHARACTERISTIC cVcAesTrboM_t_TrboMonrHPHiAvgTi /end DEF_CHARACTERISTIC /begin LOC_MEASUREMENT rVcAesTrboM_p_TrboMonrCacPTrjDif /end LOC_MEASUREMENT /end FUNCTION
/begin FUNCTION SAesTrboM61_EnabledSubsystem "" /begin LOC_MEASUREMENT rVcAesTrboM_p_TrboMonrHPLoTstVal /end LOC_MEASUREMENT /end FUNCTION
/begin FUNCTION SAesTrboM62_Subsystem "" /begin DEF_CHARACTERISTIC cVcAesTrboM_t_TrboMonrHPLoAvgTi /end DEF_CHARACTERISTIC /begin LOC_MEASUREMENT rVcAesTrboM_p_TrboMonrCacPTrjLimDif /end LOC_MEASUREMENT /end FUNCTION
/begin FUNCTION SAesTrboM63_EnabledSubsystem "" /begin LOC_MEASUREMENT rVcAesTrboM_p_TrboMonrLPHiTstVal /end LOC_MEASUREMENT /end FUNCTION
/begin FUNCTION SAesTrboM64_Subsystem "" /begin DEF_CHARACTERISTIC cVcAesTrboM_t_TrboMonrLPHiAvgTi /end DEF_CHARACTERISTIC /begin LOC_MEASUREMENT rVcAesTrboM_p_TrboMonrCacPTrjDif /end LOC_MEASUREMENT /end FUNCTION
/begin FUNCTION SAesTrboM65_EnabledSubsystem "" /begin LOC_MEASUREMENT rVcAesTrboM_p_TrboMonrLPLoTstVal /end LOC_MEASUREMENT /end FUNCTION
/begin FUNCTION SAesTrboM66_Subsystem "" /begin DEF_CHARACTERISTIC cVcAesTrboM_t_TrboMonrLPLoAvgTi /end DEF_CHARACTERISTIC /begin LOC_MEASUREMENT rVcAesTrboM_p_TrboMonrCacPTrjLimDif /end LOC_MEASUREMENT /end FUNCTION
/begin FUNCTION SAesTrboM67_EnabledSubsystem "" /begin LOC_MEASUREMENT rVcAesTrboM_p_TrboMonrHiTstVal /end LOC_MEASUREMENT /end FUNCTION
/begin FUNCTION SAesTrboM68_Subsystem "" /begin DEF_CHARACTERISTIC cVcAesTrboM_t_TrboMonrHiAvgTi /end DEF_CHARACTERISTIC /begin LOC_MEASUREMENT rVcAesTrboM_p_TrboMonrCacPTrjDif /end LOC_MEASUREMENT /end FUNCTION
/begin FUNCTION SAesTrboM69_EnabledSubsystem "" /begin LOC_MEASUREMENT rVcAesTrboM_p_TrboMonrLoTstVal /end LOC_MEASUREMENT /end FUNCTION
/begin FUNCTION SAesTrboM7_5_PpSmallLeakage "" /begin DEF_CHARACTERISTIC cVcAesTrboM_B_PpSmLkBypFiMPerm /end DEF_CHARACTERISTIC /begin LOC_MEASUREMENT xVcAesTrboM_B_ObdExe /end LOC_MEASUREMENT /begin SUB_FUNCTION SAesTrboM215_51_PpSmalLeakTest /end SUB_FUNCTION /end FUNCTION
/begin FUNCTION SAesTrboM70_Subsystem "" /begin DEF_CHARACTERISTIC cVcAesTrboM_t_TrboMonrLoAvgTi /end DEF_CHARACTERISTIC /begin LOC_MEASUREMENT rVcAesTrboM_p_TrboMonrCacPTrjLimDif /end LOC_MEASUREMENT /end FUNCTION
/begin FUNCTION SAesTrboM71_141_CoreHiBoost ""
 /begin DEF_CHARACTERISTIC cVcAesTrboM_p_TrboMonrHiErrLim cVcAesTrboM_p_TrboMonrHiErrRnkMax /end DEF_CHARACTERISTIC
 /begin LOC_MEASUREMENT rVcAesTrboM_Z_TrboMonrSHiBoostRnkVal rVcAesTrboM_p_TrboMonrHiTstVal xVcAesTrboM_B_TrboMonrSHiOk xVcAesTrboM_B_TrboMonrSHiErr /end LOC_MEASUREMENT
 /begin SUB_FUNCTION SAesTrboM83_Pr__rtional_Ranking SAesTrboM75_1411_Mode06 /end SUB_FUNCTION
/end FUNCTION
/begin FUNCTION SAesTrboM72_142_CoreLoBoost ""
 /begin DEF_CHARACTERISTIC cVcAesTrboM_p_TrboMonrLoErrLim cVcAesTrboM_p_TrboMonrLoErrRnkMax /end DEF_CHARACTERISTIC
 /begin LOC_MEASUREMENT rVcAesTrboM_Z_TrboMonrSLoBoostRnkVal rVcAesTrboM_p_TrboMonrLoTstVal xVcAesTrboM_B_TrboMonrSLoOk xVcAesTrboM_B_TrboMonrSLoErr /end LOC_MEASUREMENT
 /begin SUB_FUNCTION SAesTrboM97_Pr__rtional_Ranking SAesTrboM89_1421_Mode06 /end SUB_FUNCTION
/end FUNCTION
/begin FUNCTION SAesTrboM73_143_2T "" /begin DEF_CHARACTERISTIC cVcAesTrboM_B_TrboMUseIndHeal /end DEF_CHARACTERISTIC
 /begin LOC_MEASUREMENT xVcAesTrboM_B_TrboMonrSHiErr xVcAesTrboM_B_TrboMonrHiTstValCmplt xVcAesTrboM_B_TrboMonrHPLoTstValCmplt rVcAesTrboM_p_TrboMonrLPLoTstVal xVcAesTrboM_B_TrboMonrLPHiTstValCmplt rVcAesTrboM_p_TrboMonrHPHiTstVal xVcAesTrboM_B_TrboMonrLPLoTstValCmplt rVcAesTrboM_p_TrboMonrHPLoTstVal xVcAesTrboM_B_TrboMonrSLoErr xVcAesTrboM_B_TrboMonrLoTstValCmplt xVcAesTrboM_B_TrboMonrHPHiTstValCmplt rVcAesTrboM_p_TrboMonrLPHiTstVal xVcAesTrboM_B_TrboMonrHiErr xVcAesTrboM_B_TrboMonrLoErr xVcAesTrboM_B_TrboMonrLoOk xVcAesTrboM_B_TrboMonrHiOk /end LOC_MEASUREMENT
 /begin SUB_FUNCTION SAesTrboM106_1434_CoreHPLoBoost SAesTrboM105_1433_CoreLPLoBoost SAesTrboM104_1432_CoreHPHiBoost SAesTrboM103_1431_CoreLPHiBoost /end SUB_FUNCTION
/end FUNCTION
/begin FUNCTION SAesTrboM75_1411_Mode06 ""
 /begin DEF_CHARACTERISTIC cVcAesTrboM_B_TrboMonrMode6Enbl cVcAesTrboM_p_TrboMonrHiErrLim /end DEF_CHARACTERISTIC
 /begin LOC_MEASUREMENT rVcAesTrboM_p_TrboMonrHiTstVal /end LOC_MEASUREMENT
 /begin SUB_FUNCTION SAesTrboM85_Dem_SetDTR /end SUB_FUNCTION
/end FUNCTION
/begin FUNCTION SAesTrboM8_6_PpRelay "" /begin DEF_CHARACTERISTIC cVcAesTrboM_B_PpRlyStkFiMPerm /end DEF_CHARACTERISTIC /begin LOC_MEASUREMENT xVcAesTrboM_B_ObdExe /end LOC_MEASUREMENT /begin SUB_FUNCTION SAesTrboM227_61_RelayStuckTest /end SUB_FUNCTION /end FUNCTION
/begin FUNCTION SAesTrboM83_Pr__rtional_Ranking ""
 /begin DEF_CHARACTERISTIC cVcAesTrboM_p_TrboMonrHiErrLim cVcAesTrboM_p_TrboMonrHiErrRnkMax /end DEF_CHARACTERISTIC
 /begin LOC_MEASUREMENT xVcAesTrboM_B_TrboMonrSHiErr rVcAesTrboM_p_TrboMonrHiTstVal /end LOC_MEASUREMENT
 /begin SUB_FUNCTION SAesTrboM88_WithFault SAesTrboM87_FaultFree /end SUB_FUNCTION
/end FUNCTION
/begin FUNCTION SAesTrboM85_Dem_SetDTR "" /begin DEF_CHARACTERISTIC cVcAesTrboM_p_TrboMonrHiErrLim /end DEF_CHARACTERISTIC /end FUNCTION
/begin FUNCTION SAesTrboM87_FaultFree "" /begin DEF_CHARACTERISTIC cVcAesTrboM_p_TrboMonrHiErrLim /end DEF_CHARACTERISTIC /begin LOC_MEASUREMENT rVcAesTrboM_p_TrboMonrHiTstVal /end LOC_MEASUREMENT /end FUNCTION
/begin FUNCTION SAesTrboM88_WithFault ""
 /begin DEF_CHARACTERISTIC cVcAesTrboM_p_TrboMonrHiErrLim cVcAesTrboM_p_TrboMonrHiErrRnkMax /end DEF_CHARACTERISTIC
 /begin LOC_MEASUREMENT rVcAesTrboM_p_TrboMonrHiTstVal /end LOC_MEASUREMENT
/end FUNCTION
/begin FUNCTION SAesTrboM89_1421_Mode06 ""
 /begin DEF_CHARACTERISTIC cVcAesTrboM_B_TrboMonrMode6Enbl cVcAesTrboM_p_TrboMonrLoErrLim /end DEF_CHARACTERISTIC
 /begin LOC_MEASUREMENT rVcAesTrboM_p_TrboMonrLoTstVal /end LOC_MEASUREMENT
/end FUNCTION
/begin FUNCTION SAesTrboM9_6_VNTAdp ""
 /begin DEF_CHARACTERISTIC cVcAesTrboM_B_TrboVntAdpnActDsbl cVcAesTrboM_B_TrboVntDpFiMPerm cVcAesTrboM_B_TrboVntEngIdleDsbl cVcAesTrboM_D_TrboVntStsNOKHI cVcAesTrboM_D_TrboVntStsNOKLO cVcAesTrboM_D_TrboVntStsOK /end DEF_CHARACTERISTIC
 /begin LOC_MEASUREMENT xVcAesTrboM_B_ObdExe xVcAesTrboM_B_TrboMonrVntExeFlk xVcAesTrboM_B_TrboMonrVntAdpDone xVcAesTrboM_B_TrboMonrVntExe /end LOC_MEASUREMENT
 /begin SUB_FUNCTION SAesTrboM249_621_CoreVntDp /end SUB_FUNCTION
/end FUNCTION
/begin FUNCTION SAesTrboM97_Pr__rtional_Ranking ""
 /begin DEF_CHARACTERISTIC cVcAesTrboM_p_TrboMonrLoErrLim cVcAesTrboM_p_TrboMonrLoErrRnkMax /end DEF_CHARACTERISTIC
 /begin LOC_MEASUREMENT xVcAesTrboM_B_TrboMonrSLoErr rVcAesTrboM_p_TrboMonrLoTstVal /end LOC_MEASUREMENT
 /begin SUB_FUNCTION SAesTrboM102_WithFault SAesTrboM101_FaultFree /end SUB_FUNCTION
/end FUNCTION
/begin FUNCTION VcAesTrboM "" /begin DEF_CHARACTERISTIC cVcAesTrboM_B_IsObdExeSpm /end DEF_CHARACTERISTIC
 /begin LOC_MEASUREMENT yVcAesTrboM_B_EngProtnTrboPPeakErr sVcAesTrboM_p_TrboMonrAmbPDif xVcAesTrboM_B_ObdExe /end LOC_MEASUREMENT
 /begin OUT_MEASUREMENT yVcAesTrboM_B_TrboMonrSHiErr yVcAesTrboM_B_TrboMonrSLoErr /end OUT_MEASUREMENT
 /begin SUB_FUNCTION SAesTrboM3_1_TrboMonr SAesTrboM9_6_VNTAdp SAesTrboM8_6_PpRelay SAesTrboM7_5_PpSmallLeakage SAesTrboM6_4_PpLeakage SAesTrboM5_3_PPvalveStuckClosed SAesTrboM4_2_EngProtnTrboPPeak /end SUB_FUNCTION
/end FUNCTION
/begin RECORD_LAYOUT FLOAT32_IEEE_COL_DIRECT FNC_VALUES 1 FLOAT32_IEEE COLUMN_DIR DIRECT /end RECORD_LAYOUT
/begin RECORD_LAYOUT FLOAT32_IEEE_X_INCR_DIRECT AXIS_PTS_X 1 FLOAT32_IEEE INDEX_INCR DIRECT /end RECORD_LAYOUT
/begin RECORD_LAYOUT SBYTE_COL_DIRECT FNC_VALUES 1 SBYTE COLUMN_DIR DIRECT /end RECORD_LAYOUT
/begin RECORD_LAYOUT SWORD_X_INCR_DIRECT AXIS_PTS_X 1 SWORD INDEX_INCR DIRECT /end RECORD_LAYOUT
/begin RECORD_LAYOUT UBYTE_COL_DIRECT FNC_VALUES 1 UBYTE COLUMN_DIR DIRECT /end RECORD_LAYOUT
/begin RECORD_LAYOUT UWORD_COL_DIRECT FNC_VALUES 1 UWORD COLUMN_DIR DIRECT /end RECORD_LAYOUT
/begin RECORD_LAYOUT UWORD_X_INCR_DIRECT AXIS_PTS_X 1 UWORD INDEX_INCR DIRECT /end RECORD_LAYOUT
