/begin MEASUREMENT nvm_list_critical1._sVcTest_t_UInt32 "Enter a nice description of your variable here" ULONG VcNvm_2_1_0_s 1 0 0 4294967295 READ_WRITE ECU_ADDRESS 0x00000000 /end MEASUREMENT
/begin MEASUREMENT nvm_list_critical1._sVcTest_t_Int16 "Enter a nice description of your variable here" SWORD VcNvm_1_0_0_None 1 0 -32768 32767 READ_WRITE ECU_ADDRESS 0x00000000 /end MEASUREMENT
/begin MEASUREMENT nvm_list_critical1._sVcTest_t_UInt8 "Enter a nice description of your variable here" UBYTE VcNvm_1_0_0_None 1 0 nan nan READ_WRITE ECU_ADDRESS 0x00000000 /end MEASUREMENT
/begin COMPU_METHOD VcNvm_2_1_0_s "" RAT_FUNC /* ConversionType */ "%11.3" /* Format */ "s" /* Unit */ COEFFS 0 1 1.0 0 0 2 /end COMPU_METHOD
/begin COMPU_METHOD VcNvm_1_0_0_None "" RAT_FUNC /* ConversionType */ "%11.3" /* Format */ "-" /* Unit */ COEFFS 0 1 0.0 0 0 1 /end COMPU_METHOD
/begin FUNCTION VcNvm "" /begin LOC_MEASUREMENT sVcTest_t_UInt32 sVcTest_t_Int16 sVcTest_t_UInt8 /end LOC_MEASUREMENT /end FUNCTION
/begin RECORD_LAYOUT ULONG_COL_DIRECT FNC_VALUES 1 ULONG COLUMN_DIR DIRECT /end RECORD_LAYOUT
/begin RECORD_LAYOUT SWORD_COL_DIRECT FNC_VALUES 1 SWORD COLUMN_DIR DIRECT /end RECORD_LAYOUT
/begin RECORD_LAYOUT UBYTE_COL_DIRECT FNC_VALUES 1 UBYTE COLUMN_DIR DIRECT /end RECORD_LAYOUT
