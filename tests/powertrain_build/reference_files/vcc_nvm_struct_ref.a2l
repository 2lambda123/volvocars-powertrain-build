/begin MEASUREMENT sVcAcCtrl_t_CmprRunTiNVM "Enter a nice description of your variable here" ULONG VcNvm_1_0_0_None 1 0 nan nan READ_WRITE SYMBOL_LINK "nvm_list_32" 0 /end MEASUREMENT
/begin MEASUREMENT sVcAesHw_X_VntAdpnOffs "Enter a nice description of your variable here" FLOAT32_IEEE VcNvm_1_0_0_None 1 0 nan nan READ_WRITE SYMBOL_LINK "nvm_list_32" 4 /end MEASUREMENT
/begin MEASUREMENT sVcAesMo_Ar_ArrayTest "Enter a nice description of your variable here" FLOAT32_IEEE VcNvm_1_0_0_None 1 0 nan nan READ_WRITE MATRIX_DIM 4 2 1 SYMBOL_LINK "nvm_list_32" 8 /end MEASUREMENT
/begin MEASUREMENT sVcAesMo_Ar_NvmThrAdpn "Enter a nice description of your variable here" FLOAT32_IEEE VcNvm_1_0_0_None 1 0 nan nan READ_WRITE SYMBOL_LINK "nvm_list_32" 40 /end MEASUREMENT
/begin MEASUREMENT sVcAesMo_rt_NvmMafLrngLd1Ne1 "Enter a nice description of your variable here" UBYTE VcNvm_1_0_0_None 1 0 nan nan READ_WRITE BIT_MASK 0x01 SYMBOL_LINK "nvm_list_8" 0 /end MEASUREMENT
/begin MEASUREMENT sVcAcCtrl_t_Test1 "Enter a nice description of your variable here" ULONG VcNvm_1_0_0_None 1 0 nan nan READ_WRITE SYMBOL_LINK "nvm_list_32_per" 0 /end MEASUREMENT
/begin COMPU_METHOD VcNvm_1_0_0_None "" RAT_FUNC /* ConversionType */ "%11.3" /* Format */ "-" /* Unit */ COEFFS 0 1 0.0 0 0 1 /end COMPU_METHOD
/begin FUNCTION VcNvm ""
 /begin LOC_MEASUREMENT sVcAcCtrl_t_CmprRunTiNVM sVcAesHw_X_VntAdpnOffs sVcAesMo_Ar_ArrayTest sVcAesMo_Ar_NvmThrAdpn sVcAesMo_rt_NvmMafLrngLd1Ne1 sVcAcCtrl_t_Test1 /end LOC_MEASUREMENT
/end FUNCTION
/begin RECORD_LAYOUT ULONG_COL_DIRECT FNC_VALUES 1 ULONG COLUMN_DIR DIRECT /end RECORD_LAYOUT
/begin RECORD_LAYOUT FLOAT32_IEEE_COL_DIRECT FNC_VALUES 1 FLOAT32_IEEE COLUMN_DIR DIRECT /end RECORD_LAYOUT
/begin RECORD_LAYOUT UBYTE_COL_DIRECT FNC_VALUES 1 UBYTE COLUMN_DIR DIRECT /end RECORD_LAYOUT
