/* VcAesSupM */
/begin CHARACTERISTIC cVcAesSupM_B_SupMonrHiBypFiMPerm "Switch to bypass FiM permission, supercharger high boost monitor" VALUE 0x00000000 /* address: cVcAesSupM_B_SupMonrHiBypFiMPerm */ UBYTE_COL_DIRECT 0 VOID_SCALING 0 1 /end CHARACTERISTIC
/begin CHARACTERISTIC cVcAesSupM_B_dcl_mimic "Mimics hand coded a2l files" VALUE 0x00000000 /* address: cVcAesSupM_B_dcl_mimic */ UBYTE_COL_DIRECT 0 VOID_SCALING 0 1 /end CHARACTERISTIC
/begin CHARACTERISTIC cVcAesSupM_B_SupMonrHiCluOnSw "Switch to bypass SC clutch on flag, supercharger high boost" VALUE 0x00000000 /* address: cVcAesSupM_B_SupMonrHiCluOnSw */ UBYTE_COL_DIRECT 0 VOID_SCALING 0 1 /end CHARACTERISTIC
/begin CHARACTERISTIC cVcAesSupM_B_SupMonrLoBypFiMPerm "Switch to bypass FiM permission" VALUE 0x00000000 /* address: cVcAesSupM_B_SupMonrLoBypFiMPerm */ UBYTE_COL_DIRECT 0 VOID_SCALING 0 1 /end CHARACTERISTIC
/begin CHARACTERISTIC cVcAesSupM_B_SupMonrLoCluOnSw "Switch to bypass SC clutch on flag, supercharger low boost" VALUE 0x00000000 /* address: cVcAesSupM_B_SupMonrLoCluOnSw */ UBYTE_COL_DIRECT 0 VOID_SCALING 0 1 /end CHARACTERISTIC
/begin CHARACTERISTIC cVcAesSupM_dp_SupMonrHiSCTarNegDrv "Supercharger pressure target negative derivative enable condition, supercharger high boost" VALUE 0x00000000 /* address: cVcAesSupM_dp_SupMonrHiSCTarNegDrv */ FLOAT32_IEEE_COL_DIRECT 0 EQ_LSB_1_d -1000 0 /end CHARACTERISTIC
/begin CHARACTERISTIC cVcAesSupM_dp_SupMonrHiSCTarPosDrv "Supercharger pressure target max positive derivative enable condition, supercharger high boost" VALUE 0x00000000 /* address: cVcAesSupM_dp_SupMonrHiSCTarPosDrv */ FLOAT32_IEEE_COL_DIRECT 0 EQ_LSB_1_d 0 10000 /end CHARACTERISTIC
/begin CHARACTERISTIC cVcAesSupM_dp_SupMonrLoSCTarNegDrv "Supercharger pressure target negative derivative enable condition, supercharger low boost" VALUE 0x00000000 /* address: cVcAesSupM_dp_SupMonrLoSCTarNegDrv */ FLOAT32_IEEE_COL_DIRECT 0 EQ_LSB_1_d -1000 0 /end CHARACTERISTIC
/begin CHARACTERISTIC cVcAesSupM_dp_SupMonrLoSCTarPosDrv "Supercharger pressure target max positive derivative enable condition, supercharger low boost" VALUE 0x00000000 /* address: cVcAesSupM_dp_SupMonrLoSCTarPosDrv */ FLOAT32_IEEE_COL_DIRECT 0 EQ_LSB_1_d 0 10000 /end CHARACTERISTIC
/begin CHARACTERISTIC cVcAesSupM_m_SupMonrHiCylRevTotMax "Max load enable condition, supercharger high boost" VALUE 0x00000000 /* address: cVcAesSupM_m_SupMonrHiCylRevTotMax */ FLOAT32_IEEE_COL_DIRECT 0 EQ_LSB_1_g 0 5 /end CHARACTERISTIC
/begin CHARACTERISTIC cVcAesSupM_m_SupMonrHiCylRevTotMin "Min load enable condition, supercharger high boost " VALUE 0x00000000 /* address: cVcAesSupM_m_SupMonrHiCylRevTotMin */ FLOAT32_IEEE_COL_DIRECT 0 EQ_LSB_1_g 0 5 /end CHARACTERISTIC
/begin CHARACTERISTIC cVcAesSupM_m_SupMonrLoCylRevTotMax "Max load enable condition, supercharger low boost" VALUE 0x00000000 /* address: cVcAesSupM_m_SupMonrLoCylRevTotMax */ FLOAT32_IEEE_COL_DIRECT 0 EQ_LSB_1_g -100000 100000 /end CHARACTERISTIC
/begin CHARACTERISTIC cVcAesSupM_m_SupMonrLoCylRevTotMin "Min load enable condition, supercharger low boost" VALUE 0x00000000 /* address: cVcAesSupM_m_SupMonrLoCylRevTotMin */ FLOAT32_IEEE_COL_DIRECT 0 EQ_LSB_1_g -100000 100000 /end CHARACTERISTIC
/begin CHARACTERISTIC cVcAesSupM_n_SupMonrHiEngSpdMax "Max engine speed enable condition, supercharger high boost" VALUE 0x00000000 /* address: cVcAesSupM_n_SupMonrHiEngSpdMax */ FLOAT32_IEEE_COL_DIRECT 0 EQ_LSB_1_b 0 10000 /end CHARACTERISTIC
/begin CHARACTERISTIC cVcAesSupM_n_SupMonrHiEngSpdMin "Min engine speed enable condition, supercharger high boost " VALUE 0x00000000 /* address: cVcAesSupM_n_SupMonrHiEngSpdMin */ FLOAT32_IEEE_COL_DIRECT 0 EQ_LSB_1_b 0 10000 /end CHARACTERISTIC
/begin CHARACTERISTIC cVcAesSupM_n_SupMonrLoEngSpdMax "Max engine speed enable condition, supercharger low boost" VALUE 0x00000000 /* address: cVcAesSupM_n_SupMonrLoEngSpdMax */ FLOAT32_IEEE_COL_DIRECT 0 EQ_LSB_1_b -100000 100000 /end CHARACTERISTIC
/begin CHARACTERISTIC cVcAesSupM_n_SupMonrLoEngSpdMin "Min engine speed enable condition, supercharger low boost " VALUE 0x00000000 /* address: cVcAesSupM_n_SupMonrLoEngSpdMin */ FLOAT32_IEEE_COL_DIRECT 0 EQ_LSB_1_b -100000 100000 /end CHARACTERISTIC
/begin CHARACTERISTIC cVcAesSupM_p_SupChrgrPPeakHealLim "Supercharger pressure peak healing delay" VALUE 0x00000000 /* address: cVcAesSupM_p_SupChrgrPPeakHealLim */ FLOAT32_IEEE_COL_DIRECT 0 EQ_LSB_1 0 200 /end CHARACTERISTIC
/begin CHARACTERISTIC cVcAesSupM_p_SupChrgrStuckErrLim "Error limit for stuck supercharger engine protection (prot off under this limit)" VALUE 0x00000000 /* address: cVcAesSupM_p_SupChrgrStuckErrLim */ FLOAT32_IEEE_COL_DIRECT 0 EQ_LSB_1 0 500 /end CHARACTERISTIC
/begin CHARACTERISTIC cVcAesSupM_p_SupMonrHiAmbpMin "Min ambient pressure enable condition, supercharger high boost " VALUE 0x00000000 /* address: cVcAesSupM_p_SupMonrHiAmbpMin */ FLOAT32_IEEE_COL_DIRECT 0 EQ_LSB_1 0 110 /end CHARACTERISTIC
/begin CHARACTERISTIC cVcAesSupM_p_SupMonrHiTarMin "Min target boost pressure enable condition, supercharger high boost " VALUE 0x00000000 /* address: cVcAesSupM_p_SupMonrHiTarMin */ FLOAT32_IEEE_COL_DIRECT 0 EQ_LSB_1 -1000 1000 /end CHARACTERISTIC
/begin CHARACTERISTIC cVcAesSupM_p_SupMonrLoAmbpMin "Min ambient pressure enable condition, supercharger low boost " VALUE 0x00000000 /* address: cVcAesSupM_p_SupMonrLoAmbpMin */ FLOAT32_IEEE_COL_DIRECT 0 EQ_LSB_1 -100000 100000 /end CHARACTERISTIC
/begin CHARACTERISTIC cVcAesSupM_p_SupMonrLoTarMax "Min target boost pressure enable condition, supercharger low boost " VALUE 0x00000000 /* address: cVcAesSupM_p_SupMonrLoTarMax */ FLOAT32_IEEE_COL_DIRECT 0 EQ_LSB_1 0 200 /end CHARACTERISTIC
/begin CHARACTERISTIC cVcAesSupM_p_SupMonrLoTarMin "Min target boost pressure enable condition, supercharger low boost " VALUE 0x00000000 /* address: cVcAesSupM_p_SupMonrLoTarMin */ FLOAT32_IEEE_COL_DIRECT 0 EQ_LSB_1 -1000 1000 /end CHARACTERISTIC
/begin CHARACTERISTIC cVcAesSupM_t_SupChrgrPPeakErrDly "Supercharger peak pressure engine protection activation delay" VALUE 0x00000000 /* address: cVcAesSupM_t_SupChrgrPPeakErrDly */ FLOAT32_IEEE_COL_DIRECT 0 EQ_LSB_1_c 0 1000 /end CHARACTERISTIC
/begin CHARACTERISTIC cVcAesSupM_t_SupChrgrPPeakHealDly "Supercharger peak pressure engine protection deactivation delay" VALUE 0x00000000 /* address: cVcAesSupM_t_SupChrgrPPeakHealDly */ FLOAT32_IEEE_COL_DIRECT 0 EQ_LSB_1_c 0 3.402823466e38 /end CHARACTERISTIC
/begin CHARACTERISTIC cVcAesSupM_t_SupChrgrStuckErrDly "Supercharger Stuck engine protection activation delay" VALUE 0x00000000 /* address: cVcAesSupM_t_SupChrgrStuckErrDly */ FLOAT32_IEEE_COL_DIRECT 0 EQ_LSB_1_c 0 1000 /end CHARACTERISTIC
/begin CHARACTERISTIC cVcAesSupM_t_SupChrgrStuckHealDly "Supercharger stuck engine protection deactivation delay (allow retest after this delay time)" VALUE 0x00000000 /* address: cVcAesSupM_t_SupChrgrStuckHealDly */ FLOAT32_IEEE_COL_DIRECT 0 EQ_LSB_1_c 0 3.402823466e38 /end CHARACTERISTIC
/begin CHARACTERISTIC cVcAesSupM_t_SupChrgrStuckRefResetDly "Supercharger Stuck monitor maximum activation time" VALUE 0x00000000 /* address: cVcAesSupM_t_SupChrgrStuckRefResetDly */ FLOAT32_IEEE_COL_DIRECT 0 EQ_LSB_1_c 0 3.402823466e38 /end CHARACTERISTIC
/begin CHARACTERISTIC cVcAesSupM_t_SupMonrHiAvgTi "Supercharger high boost test value average calculation time" VALUE 0x00000000 /* address: cVcAesSupM_t_SupMonrHiAvgTi */ FLOAT32_IEEE_COL_DIRECT 0 EQ_LSB_1_c 0 100 /end CHARACTERISTIC
/begin CHARACTERISTIC cVcAesSupM_t_SupMonrLoAvgTi "Supercharger low boost test value average calculation time" VALUE 0x00000000 /* address: cVcAesSupM_t_SupMonrLoAvgTi */ FLOAT32_IEEE_COL_DIRECT 0 EQ_LSB_1_c 0 100 /end CHARACTERISTIC
/begin CHARACTERISTIC cVcAesSupM_tc_SupMonrHiSCTar "Supercharger boost pressure monitor, target pressure deriviative time constant" VALUE 0x00000000 /* address: cVcAesSupM_tc_SupMonrHiSCTar */ FLOAT32_IEEE_COL_DIRECT 0 EQ_LSB_1_c 0 1000 /end CHARACTERISTIC
/begin CHARACTERISTIC cVcAesSupM_tc_SupMonrHiTiConCmprThr "Supercharger bypass throttle position derivative time constant, supercharger high boost" VALUE 0x00000000 /* address: cVcAesSupM_tc_SupMonrHiTiConCmprThr */ FLOAT32_IEEE_COL_DIRECT 0 EQ_LSB_1_c 0 100 /end CHARACTERISTIC
/begin CHARACTERISTIC cVcAesSupM_tc_SupMonrLoSCTar "Supercharger boost pressure monitor, target pressure deriviative time constant, supercharger low boost" VALUE 0x00000000 /* address: cVcAesSupM_tc_SupMonrLoSCTar */ FLOAT32_IEEE_COL_DIRECT 0 EQ_LSB_1_c 0 1000 /end CHARACTERISTIC
/begin CHARACTERISTIC cVcAesSupM_tc_SupMonrLoTiConCmprThr "Supercharger bypass throttle position derivative time constant, supercharger low boost" VALUE 0x00000000 /* address: cVcAesSupM_tc_SupMonrLoTiConCmprThr */ FLOAT32_IEEE_COL_DIRECT 0 EQ_LSB_1_c 0 100 /end CHARACTERISTIC
/begin CHARACTERISTIC cVcAesSupM_Te_SupMonrHiTempMin "Min temperature upstream SC enable condition, supercharger high boost " VALUE 0x00000000 /* address: cVcAesSupM_Te_SupMonrHiTempMin */ FLOAT32_IEEE_COL_DIRECT 0 EQ_LSB_1_a -40 500 /end CHARACTERISTIC
/begin CHARACTERISTIC cVcAesSupM_Te_SupMonrLoTempMin "Min temperature upstream SC enable condition, supercharger low boost " VALUE 0x00000000 /* address: cVcAesSupM_Te_SupMonrLoTempMin */ FLOAT32_IEEE_COL_DIRECT 0 EQ_LSB_1_a -100000 100000 /end CHARACTERISTIC
/begin CHARACTERISTIC cVcAesSupM_X_SupChrgrStuckThrPosMaxLim "Error limit for stuck supercharger engine protection (prot off under this limit)" VALUE 0x00000000 /* address: cVcAesSupM_X_SupChrgrStuckThrPosMaxLim */ FLOAT32_IEEE_COL_DIRECT 0 EQ_LSB_1_k 0 500 /end CHARACTERISTIC
/begin CHARACTERISTIC cVcAesSupM_X_SupChrgrStuckThrPosRefLim "Bypass throttle max limit to freeze pressure reference value" VALUE 0x00000000 /* address: cVcAesSupM_X_SupChrgrStuckThrPosRefLim */ FLOAT32_IEEE_COL_DIRECT 0 EQ_LSB_1_k 0 500 /end CHARACTERISTIC
/begin CHARACTERISTIC cVcAesSupM_X_SupMonrHiCmprThrMaxLim "Supercharger throttle enable coindition, SC high boost" VALUE 0x00000000 /* address: cVcAesSupM_X_SupMonrHiCmprThrMaxLim */ FLOAT32_IEEE_COL_DIRECT 0 EQ_LSB_1_k 0 110 /end CHARACTERISTIC
/begin CHARACTERISTIC cVcAesSupM_X_SupMonrHiThrNegDrv "Supercharger throttle max negative derivative enable condition, supercharger high boost" VALUE 0x00000000 /* address: cVcAesSupM_X_SupMonrHiThrNegDrv */ FLOAT32_IEEE_COL_DIRECT 0 EQ_LSB_1_l -1000 0 /end CHARACTERISTIC
/begin CHARACTERISTIC cVcAesSupM_X_SupMonrHiThrPosDrv "Supercharger throttle max positive derivative enable condition, supercharger high boost" VALUE 0x00000000 /* address: cVcAesSupM_X_SupMonrHiThrPosDrv */ FLOAT32_IEEE_COL_DIRECT 0 EQ_LSB_1_l 0 1000 /end CHARACTERISTIC
/begin CHARACTERISTIC cVcAesSupM_X_SupMonrLoThrMaxLim "Supercharger throttle enable coindition, SC low boost" VALUE 0x00000000 /* address: cVcAesSupM_X_SupMonrLoThrMaxLim */ FLOAT32_IEEE_COL_DIRECT 0 EQ_LSB_1_k 0 300 /end CHARACTERISTIC
/begin CHARACTERISTIC cVcAesSupM_X_SupMonrLoThrMinLim "Supercharger throttle enable coindition, SC low boost" VALUE 0x00000000 /* address: cVcAesSupM_X_SupMonrLoThrMinLim */ FLOAT32_IEEE_COL_DIRECT 0 EQ_LSB_1_k -10 100 /end CHARACTERISTIC
/begin CHARACTERISTIC cVcAesSupM_X_SupMonrLoThrNegDrv "Supercharger throttle max negative derivative enable condition, supercharger low boost" VALUE 0x00000000 /* address: cVcAesSupM_X_SupMonrLoThrNegDrv */ FLOAT32_IEEE_COL_DIRECT 0 EQ_LSB_1_l -1000 0 /end CHARACTERISTIC
/begin CHARACTERISTIC cVcAesSupM_X_SupMonrLoThrPosDrv "Supercharger throttle max positive derivative enable condition, supercharger low boost" VALUE 0x00000000 /* address: cVcAesSupM_X_SupMonrLoThrPosDrv */ FLOAT32_IEEE_COL_DIRECT 0 EQ_LSB_1_l 0 1000 /end CHARACTERISTIC
/begin CHARACTERISTIC mVcAesSupM_m_SupChrgrStuckMaxLoadLim "Supercharger stuck load limit" MAP 0x00000000 /* address: mVcAesSupM_m_SupChrgrStuckMaxLoadLim */ UWORD_COL_DIRECT 0 EQ_LSB_0_000244140625 0 5
 /begin AXIS_DESCR COM_AXIS NO_INPUT_QUANTITY EQ_LSB_0_00390625 3 0 200 AXIS_PTS_REF mVcAesSupM_m_SupChrgrStuckMaxLoadLim_r DEPOSIT ABSOLUTE /end AXIS_DESCR
 /begin AXIS_DESCR COM_AXIS NO_INPUT_QUANTITY EQ_LSB_0_25 4 0 10000 AXIS_PTS_REF mVcAesSupM_m_SupChrgrStuckMaxLoadLim_c DEPOSIT ABSOLUTE /end AXIS_DESCR
/end CHARACTERISTIC
/begin CHARACTERISTIC tVcAesSupM_fac_SupChrgrStuckMaxLoadCmp "temperature factor for load limit compensation" CURVE 0x00000000 /* address: tVcAesSupM_fac_SupChrgrStuckMaxLoadCmp */ UWORD_COL_DIRECT 0 EQ_LSB_6_103515625em05 0 3.99
 /begin AXIS_DESCR COM_AXIS NO_INPUT_QUANTITY EQ_LSB_0_03125 4 0 1000 AXIS_PTS_REF tVcAesSupM_fac_SupChrgrStuckMaxLoadCmp_x DEPOSIT ABSOLUTE /end AXIS_DESCR
/end CHARACTERISTIC
/begin CHARACTERISTIC tVcAesSupM_p_SupChrgrPPeakLim "Supercharger peak boost pressure protection activation limit" CURVE 0x00000000 /* address: tVcAesSupM_p_SupChrgrPPeakLim */ FLOAT32_IEEE_COL_DIRECT 0 EQ_LSB_1 -3.4028234663852886e38 3.4028234663852886e38
 /begin AXIS_DESCR COM_AXIS NO_INPUT_QUANTITY EQ_LSB_1_a 4 0 1000 AXIS_PTS_REF tVcAesSupM_p_SupChrgrPPeakLim_x DEPOSIT ABSOLUTE /end AXIS_DESCR
/end CHARACTERISTIC
/begin CHARACTERISTIC tVcAesSupM_p_SupMonrHiErrLim "Supercharger high boost pressure monitor error limit" CURVE 0x00000000 /* address: tVcAesSupM_p_SupMonrHiErrLim */ FLOAT32_IEEE_COL_DIRECT 0 EQ_LSB_1 -50 200
 /begin AXIS_DESCR COM_AXIS NO_INPUT_QUANTITY EQ_LSB_1_b 6 0 10000 AXIS_PTS_REF tVcAesSupM_p_SupMonrHiErrLim_x DEPOSIT ABSOLUTE /end AXIS_DESCR
/end CHARACTERISTIC
/begin CHARACTERISTIC tVcAesSupM_p_SupMonrLoErrLim "Supercharger low boost pressure monitor error limit" CURVE 0x00000000 /* address: tVcAesSupM_p_SupMonrLoErrLim */ FLOAT32_IEEE_COL_DIRECT 0 EQ_LSB_1 -200 50
 /begin AXIS_DESCR COM_AXIS NO_INPUT_QUANTITY EQ_LSB_1_b 6 0 10000 AXIS_PTS_REF tVcAesSupM_p_SupMonrLoErrLim_x DEPOSIT ABSOLUTE /end AXIS_DESCR
/end CHARACTERISTIC
/begin CHARACTERISTIC tVcAesSupM_t_SupMonrHiEnaDly "Supercharger high boost pressure monitor, enable condition delay time" CURVE 0x00000000 /* address: tVcAesSupM_t_SupMonrHiEnaDly */ FLOAT32_IEEE_COL_DIRECT 0 EQ_LSB_1_c 0 100
 /begin AXIS_DESCR COM_AXIS NO_INPUT_QUANTITY EQ_LSB_1_a 5 -50 500 AXIS_PTS_REF tVcAesSupM_t_SupMonrHiEnaDly_x DEPOSIT ABSOLUTE /end AXIS_DESCR
/end CHARACTERISTIC
/begin CHARACTERISTIC tVcAesSupM_t_SupMonrLoEnaDly "Supercharger low boost pressure monitor, enable condition delay time" CURVE 0x00000000 /* address: tVcAesSupM_t_SupMonrLoEnaDly */ FLOAT32_IEEE_COL_DIRECT 0 EQ_LSB_1_c 0 100
 /begin AXIS_DESCR COM_AXIS NO_INPUT_QUANTITY EQ_LSB_1_a 5 -50 500 AXIS_PTS_REF tVcAesSupM_t_SupMonrLoEnaDly_x DEPOSIT ABSOLUTE /end AXIS_DESCR
/end CHARACTERISTIC
/begin CHARACTERISTIC tVcAesSupM_tc_SupMonrSCTarDly "Supercharger boost pressure monitor, target pressure lowpass filter time constant, engine speed support points" CURVE 0x00000000 /* address: tVcAesSupM_tc_SupMonrSCTarDly */ FLOAT32_IEEE_COL_DIRECT 0 EQ_LSB_1_c 0 100
 /begin AXIS_DESCR COM_AXIS NO_INPUT_QUANTITY EQ_LSB_1_b 6 0 10000 AXIS_PTS_REF tVcAesSupM_tc_SupMonrSCTarDly_x DEPOSIT ABSOLUTE /end AXIS_DESCR
/end CHARACTERISTIC
/begin AXIS_PTS mVcAesSupM_m_SupChrgrStuckMaxLoadLim_c "Engine speed breakpoint data for supercharger stuck load limit " 0x00000000 NO_INPUT_QUANTITY UWORD_X_INCR_DIRECT 0 EQ_LSB_0_25 4 0 10000 DEPOSIT ABSOLUTE /end AXIS_PTS
/begin AXIS_PTS mVcAesSupM_m_SupChrgrStuckMaxLoadLim_r "Ambient Pressure breakpoint data for supercharger stuck load limit " 0x00000000 NO_INPUT_QUANTITY UWORD_X_INCR_DIRECT 0 EQ_LSB_0_00390625 3 0 200 DEPOSIT ABSOLUTE /end AXIS_PTS
/begin AXIS_PTS tVcAesSupM_fac_SupChrgrStuckMaxLoadCmp_x "Temperature correction for supercharger stuck load limit" 0x00000000 NO_INPUT_QUANTITY UWORD_X_INCR_DIRECT 0 EQ_LSB_0_03125 4 0 1000 DEPOSIT ABSOLUTE /end AXIS_PTS
/begin AXIS_PTS tVcAesSupM_p_SupChrgrPPeakLim_x "Supercharger downstream temperature breakpoint data" 0x00000000 NO_INPUT_QUANTITY FLOAT32_IEEE_X_INCR_DIRECT 0 EQ_LSB_1_a 4 0 1000 DEPOSIT ABSOLUTE /end AXIS_PTS
/begin AXIS_PTS tVcAesSupM_p_SupMonrHiErrLim_x "Supercharger high boost pressure monitor error limit engine speed support points" 0x00000000 NO_INPUT_QUANTITY FLOAT32_IEEE_X_INCR_DIRECT 0 EQ_LSB_1_b 6 0 10000 DEPOSIT ABSOLUTE /end AXIS_PTS
/begin AXIS_PTS tVcAesSupM_p_SupMonrLoErrLim_x "Supercharger low boost pressure monitor error limit engine speed support points" 0x00000000 NO_INPUT_QUANTITY FLOAT32_IEEE_X_INCR_DIRECT 0 EQ_LSB_1_b 6 0 10000 DEPOSIT ABSOLUTE /end AXIS_PTS
/begin AXIS_PTS tVcAesSupM_t_SupMonrHiEnaDly_x "Supercharger high boost pressure monitor, enable condition delay time support points" 0x00000000 NO_INPUT_QUANTITY FLOAT32_IEEE_X_INCR_DIRECT 0 EQ_LSB_1_a 5 -50 500 DEPOSIT ABSOLUTE /end AXIS_PTS
/begin AXIS_PTS tVcAesSupM_t_SupMonrLoEnaDly_x "Supercharger low boost pressure monitor, enable condition delay time support points" 0x00000000 NO_INPUT_QUANTITY FLOAT32_IEEE_X_INCR_DIRECT 0 EQ_LSB_1_a 5 -50 500 DEPOSIT ABSOLUTE /end AXIS_PTS
/begin AXIS_PTS tVcAesSupM_tc_SupMonrSCTarDly_x "Supercharger boost pressure monitor, target pressure lowpass filter time constant, engine speed support points" 0x00000000 NO_INPUT_QUANTITY FLOAT32_IEEE_X_INCR_DIRECT 0 EQ_LSB_1_b 6 0 10000 DEPOSIT ABSOLUTE /end AXIS_PTS
/begin MEASUREMENT rVcAesSupM_fac_SupChrgrStuckMaxLoadCmp "temperature factor for load limit compensation" FLOAT32_IEEE EQ_LSB_1_h 1 0 0 1 READ_WRITE /begin IF_DATA ASAP1B_ADDRESS KP_BLOB 0x00000000 /end IF_DATA /end MEASUREMENT
/begin MEASUREMENT rVcAesSupM_m_SupChrgrStuckMaxLoadLim "Supercharger stuck load limit" FLOAT32_IEEE EQ_LSB_1_g 1 0 -3.4028234663852886e38 3.4028234663852886e38 READ_WRITE /begin IF_DATA ASAP1B_ADDRESS KP_BLOB 0x00000000 /end IF_DATA /end MEASUREMENT
/begin MEASUREMENT rVcAesSupM_m_SupChrgrStuckMaxLoadLimBase "Supercharger stuck load limit" FLOAT32_IEEE EQ_LSB_1_g 1 0 0 5 READ_WRITE /begin IF_DATA ASAP1B_ADDRESS KP_BLOB 0x00000000 /end IF_DATA /end MEASUREMENT
/begin MEASUREMENT rVcAesSupM_p_SupChgrStuckPDiff "Diff pressure before/after supercharger engagement" FLOAT32_IEEE EQ_LSB_1 1 0 -300 300 READ_WRITE /begin IF_DATA ASAP1B_ADDRESS KP_BLOB 0x00000000 /end IF_DATA /end MEASUREMENT
/begin MEASUREMENT rVcAesSupM_p_SupChrgrPDsAtmDiff "Over pressure downstream supercharger" FLOAT32_IEEE EQ_LSB_1 1 0 -3.4028234663852886e38 3.4028234663852886e38 READ_WRITE /begin IF_DATA ASAP1B_ADDRESS KP_BLOB 0x00000000 /end IF_DATA /end MEASUREMENT
/begin MEASUREMENT rVcAesSupM_p_SupChrgrStuckPDiffMax "Maximum supercharger diff pressure during stuck test" FLOAT32_IEEE EQ_LSB_1 1 0 -500 500 READ_WRITE /begin IF_DATA ASAP1B_ADDRESS KP_BLOB 0x00000000 /end IF_DATA /end MEASUREMENT
/begin MEASUREMENT rVcAesSupM_p_SupMonrHiTstVal "Supercharger high boost pressure test value " FLOAT32_IEEE EQ_LSB_1 1 0 -300 300 READ_WRITE /begin IF_DATA ASAP1B_ADDRESS KP_BLOB 0x00000000 /end IF_DATA /end MEASUREMENT
/begin MEASUREMENT rVcAesSupM_p_SupMonrLoTstVal "Supercharger low boost pressure test value " FLOAT32_IEEE EQ_LSB_1 1 0 -300 300 READ_WRITE /begin IF_DATA ASAP1B_ADDRESS KP_BLOB 0x00000000 /end IF_DATA /end MEASUREMENT
/begin MEASUREMENT rVcAesSupM_p_SupMonrPDif "Supercharger actual- and target pressure difference" FLOAT32_IEEE EQ_LSB_1 1 0 -300 300 READ_WRITE /begin IF_DATA ASAP1B_ADDRESS KP_BLOB 0x00000000 /end IF_DATA /end MEASUREMENT
/begin MEASUREMENT rVcAesSupM_p_SupMonrSCTar "Supercharger target boost pressure, compensated for ambient pressure" FLOAT32_IEEE EQ_LSB_1 1 0 -300 300 READ_WRITE /begin IF_DATA ASAP1B_ADDRESS KP_BLOB 0x00000000 /end IF_DATA /end MEASUREMENT
/begin MEASUREMENT rVcAesSupM_p_SupMonrSCTarDly "Low pass filtered supercharger target pressure" FLOAT32_IEEE EQ_LSB_1 1 0 0 300 READ_WRITE /begin IF_DATA ASAP1B_ADDRESS KP_BLOB 0x00000000 /end IF_DATA /end MEASUREMENT
/begin MEASUREMENT rVcAesSupM_Z_SupMonrHiBoostRnkVal "Supercharger high boost ranking value" FLOAT32_IEEE VOID_SCALING_f 1 0 0 255 READ_WRITE /begin IF_DATA ASAP1B_ADDRESS KP_BLOB 0x00000000 /end IF_DATA /end MEASUREMENT
/begin MEASUREMENT rVcAesSupM_Z_SupMonrHiSCTarDrv "Trajectory differential" FLOAT32_IEEE EQ_LSB_1_d 1 0 -100000 100000 READ_WRITE /begin IF_DATA ASAP1B_ADDRESS KP_BLOB 0x00000000 /end IF_DATA /end MEASUREMENT
/begin MEASUREMENT rVcAesSupM_Z_SupMonrHiSCThrDrv "Trajectory differential" FLOAT32_IEEE EQ_LSB_1_d 1 0 -100000 100000 READ_WRITE /begin IF_DATA ASAP1B_ADDRESS KP_BLOB 0x00000000 /end IF_DATA /end MEASUREMENT
/begin MEASUREMENT rVcAesSupM_Z_SupMonrLoBoostRnkVal "Supercharger low boost ranking value" FLOAT32_IEEE VOID_SCALING_f 1 0 0 255 READ_WRITE /begin IF_DATA ASAP1B_ADDRESS KP_BLOB 0x00000000 /end IF_DATA /end MEASUREMENT
/begin MEASUREMENT rVcAesSupM_Z_SupMonrLoSCTarDrv "Trajectory differential" FLOAT32_IEEE EQ_LSB_1_d 1 0 -100000 100000 READ_WRITE /begin IF_DATA ASAP1B_ADDRESS KP_BLOB 0x00000000 /end IF_DATA /end MEASUREMENT
/begin MEASUREMENT rVcAesSupM_Z_SupMonrLoSCThrDrv "Trajectory differential" FLOAT32_IEEE EQ_LSB_1_d 1 0 -100000 100000 READ_WRITE /begin IF_DATA ASAP1B_ADDRESS KP_BLOB 0x00000000 /end IF_DATA /end MEASUREMENT
/begin MEASUREMENT xVcAesSupM_B_SupChrgrPPeakErr "Engine protection from high supercharger pressure activation flag" UBYTE VOID_SCALING 1 0 0 1 BIT_MASK 0x1 READ_WRITE /begin IF_DATA ASAP1B_ADDRESS KP_BLOB 0x00000000 /end IF_DATA /end MEASUREMENT
/begin MEASUREMENT xVcAesSupM_B_SupChrgrStuckEnable "SC CLutch and bypass throttle Enable conditions enabled" UBYTE VOID_SCALING 1 0 0 1 BIT_MASK 0x1 READ_WRITE /begin IF_DATA ASAP1B_ADDRESS KP_BLOB 0x00000000 /end IF_DATA /end MEASUREMENT
/begin MEASUREMENT xVcAesSupM_B_SupChrgrStuckErr "Engine protection from high supercharger pressure activation flag" UBYTE VOID_SCALING 1 0 0 1 BIT_MASK 0x1 READ_WRITE /begin IF_DATA ASAP1B_ADDRESS KP_BLOB 0x00000000 /end IF_DATA /end MEASUREMENT
/begin MEASUREMENT xVcAesSupM_B_SupChrgrStuckExe "Supercharger stuck monitor executes" UBYTE VOID_SCALING 1 0 0 1 BIT_MASK 0x1 READ_WRITE /begin IF_DATA ASAP1B_ADDRESS KP_BLOB 0x00000000 /end IF_DATA /end MEASUREMENT
/begin MEASUREMENT xVcAesSupM_B_SupChrgrStuckUnfiltErr "Supercharger stuck error, unfiltered" UBYTE VOID_SCALING 1 0 0 1 BIT_MASK 0x1 READ_WRITE /begin IF_DATA ASAP1B_ADDRESS KP_BLOB 0x00000000 /end IF_DATA /end MEASUREMENT
/begin MEASUREMENT xVcAesSupM_B_SupMonrHiAmbpEna "Ambient pressure enable condition, supercharger high boost" UBYTE VOID_SCALING 1 0 0 1 BIT_MASK 0x1 READ_WRITE /begin IF_DATA ASAP1B_ADDRESS KP_BLOB 0x00000000 /end IF_DATA /end MEASUREMENT
/begin MEASUREMENT xVcAesSupM_B_SupMonrHiCluOnEna "Supercharger clutch enable condition, supercharger high boost" UBYTE VOID_SCALING 1 0 0 1 BIT_MASK 0x1 READ_WRITE /begin IF_DATA ASAP1B_ADDRESS KP_BLOB 0x00000000 /end IF_DATA /end MEASUREMENT
/begin MEASUREMENT xVcAesSupM_B_SupMonrHiCmprThrEna "Supercharger bypass throttle enable condition, supercharger high boost" UBYTE VOID_SCALING 1 0 0 1 BIT_MASK 0x1 READ_WRITE /begin IF_DATA ASAP1B_ADDRESS KP_BLOB 0x00000000 /end IF_DATA /end MEASUREMENT
/begin MEASUREMENT xVcAesSupM_B_SupMonrHiCylRevEna "Engine load enable condition, supercharger high boost" UBYTE VOID_SCALING 1 0 0 1 BIT_MASK 0x1 READ_WRITE /begin IF_DATA ASAP1B_ADDRESS KP_BLOB 0x00000000 /end IF_DATA /end MEASUREMENT
/begin MEASUREMENT xVcAesSupM_B_SupMonrHiEna "" UBYTE VOID_SCALING 1 0 0 1 BIT_MASK 0x1 READ_WRITE /begin IF_DATA ASAP1B_ADDRESS KP_BLOB 0x00000000 /end IF_DATA /end MEASUREMENT
/begin MEASUREMENT xVcAesSupM_B_SupMonrHiEngSpdEna "Engine speed enable condition, supercharger high boost" UBYTE VOID_SCALING 1 0 0 1 BIT_MASK 0x1 READ_WRITE /begin IF_DATA ASAP1B_ADDRESS KP_BLOB 0x00000000 /end IF_DATA /end MEASUREMENT
/begin MEASUREMENT xVcAesSupM_B_SupMonrHiErr "Supercharger boost pressure to high error" UBYTE VOID_SCALING 1 0 0 1 BIT_MASK 0x1 READ_WRITE /begin IF_DATA ASAP1B_ADDRESS KP_BLOB 0x00000000 /end IF_DATA /end MEASUREMENT
/begin MEASUREMENT xVcAesSupM_B_SupMonrHiExe "High boost pressure monitor entry condition" UBYTE VOID_SCALING 1 0 0 1 BIT_MASK 0x1 READ_WRITE /begin IF_DATA ASAP1B_ADDRESS KP_BLOB 0x00000000 /end IF_DATA /end MEASUREMENT
/begin MEASUREMENT xVcAesSupM_B_SupMonrHiOk "Supercharger monitor high boost OK" UBYTE VOID_SCALING 1 0 0 1 BIT_MASK 0x1 READ_WRITE /begin IF_DATA ASAP1B_ADDRESS KP_BLOB 0x00000000 /end IF_DATA /end MEASUREMENT
/begin MEASUREMENT xVcAesSupM_B_SupMonrHiSCTarDrvEna "Supercharger target pressure derivative enable condition, supercharger high boost" UBYTE VOID_SCALING 1 0 0 1 BIT_MASK 0x1 READ_WRITE /begin IF_DATA ASAP1B_ADDRESS KP_BLOB 0x00000000 /end IF_DATA /end MEASUREMENT
/begin MEASUREMENT xVcAesSupM_B_SupMonrHiSCTempEna "Supercharger inlet temperature enable condition, supercharger high boost" UBYTE VOID_SCALING 1 0 0 1 BIT_MASK 0x1 READ_WRITE /begin IF_DATA ASAP1B_ADDRESS KP_BLOB 0x00000000 /end IF_DATA /end MEASUREMENT
/begin MEASUREMENT xVcAesSupM_B_SupMonrHiStabEna "Delayed trajectory pressure stable entry condition" UBYTE VOID_SCALING 1 0 0 1 BIT_MASK 0x1 READ_WRITE /begin IF_DATA ASAP1B_ADDRESS KP_BLOB 0x00000000 /end IF_DATA /end MEASUREMENT
/begin MEASUREMENT xVcAesSupM_B_SupMonrHiTarEna "Supercharger target pressure enable condition, supercharger high boost" UBYTE VOID_SCALING 1 0 0 1 BIT_MASK 0x1 READ_WRITE /begin IF_DATA ASAP1B_ADDRESS KP_BLOB 0x00000000 /end IF_DATA /end MEASUREMENT
/begin MEASUREMENT xVcAesSupM_B_SupMonrHiThrDrvEna "Supercharger bypass throttle derivative enable condition, supercharger high boost" UBYTE VOID_SCALING 1 0 0 1 BIT_MASK 0x1 READ_WRITE /begin IF_DATA ASAP1B_ADDRESS KP_BLOB 0x00000000 /end IF_DATA /end MEASUREMENT
/begin MEASUREMENT xVcAesSupM_B_SupMonrHiTstValCmplt "Supercharger high boost pressure monitor test value (average calculation) complete" UBYTE VOID_SCALING 1 0 0 1 BIT_MASK 0x1 READ_WRITE /begin IF_DATA ASAP1B_ADDRESS KP_BLOB 0x00000000 /end IF_DATA /end MEASUREMENT
/begin MEASUREMENT xVcAesSupM_B_SupMonrLoAmbpEna "Ambient pressure enable condition, supercharger low boost" UBYTE VOID_SCALING 1 0 0 1 BIT_MASK 0x1 READ_WRITE /begin IF_DATA ASAP1B_ADDRESS KP_BLOB 0x00000000 /end IF_DATA /end MEASUREMENT
/begin MEASUREMENT xVcAesSupM_B_SupMonrLoCluOnEna "Supercharger clutch enable condition, supercharger low boost" UBYTE VOID_SCALING 1 0 0 1 BIT_MASK 0x1 READ_WRITE /begin IF_DATA ASAP1B_ADDRESS KP_BLOB 0x00000000 /end IF_DATA /end MEASUREMENT
/begin MEASUREMENT xVcAesSupM_B_SupMonrLoCmprThrEna "Supercharger target pressure derivative enable condition, supercharger low boost" UBYTE EQ_LSB_1_e 1 0 0 1 BIT_MASK 0x1 READ_WRITE /begin IF_DATA ASAP1B_ADDRESS KP_BLOB 0x00000000 /end IF_DATA /end MEASUREMENT
/begin MEASUREMENT xVcAesSupM_B_SupMonrLoCmprThrMaxEna "Supercharger bypass throttle enable condition, supercharger low boost" UBYTE EQ_LSB_1_e 1 0 0 1 BIT_MASK 0x1 READ_WRITE /begin IF_DATA ASAP1B_ADDRESS KP_BLOB 0x00000000 /end IF_DATA /end MEASUREMENT
/begin MEASUREMENT xVcAesSupM_B_SupMonrLoCmprThrMinEna "Supercharger bypass throttle enable condition, supercharger low boost" UBYTE EQ_LSB_1_e 1 0 0 1 BIT_MASK 0x1 READ_WRITE /begin IF_DATA ASAP1B_ADDRESS KP_BLOB 0x00000000 /end IF_DATA /end MEASUREMENT
/begin MEASUREMENT xVcAesSupM_B_SupMonrLoCylRevEna "Engine load enable condition, supercharger low boost" UBYTE VOID_SCALING 1 0 0 1 BIT_MASK 0x1 READ_WRITE /begin IF_DATA ASAP1B_ADDRESS KP_BLOB 0x00000000 /end IF_DATA /end MEASUREMENT
/begin MEASUREMENT xVcAesSupM_B_SupMonrLoEna "" UBYTE VOID_SCALING 1 0 0 1 BIT_MASK 0x1 READ_WRITE /begin IF_DATA ASAP1B_ADDRESS KP_BLOB 0x00000000 /end IF_DATA /end MEASUREMENT
/begin MEASUREMENT xVcAesSupM_B_SupMonrLoEngSpdEna "Engine speed enable condition, supercharger low boost" UBYTE VOID_SCALING 1 0 0 1 BIT_MASK 0x1 READ_WRITE /begin IF_DATA ASAP1B_ADDRESS KP_BLOB 0x00000000 /end IF_DATA /end MEASUREMENT
/begin MEASUREMENT xVcAesSupM_B_SupMonrLoErr "Supercharger boost pressure too low error" UBYTE VOID_SCALING 1 0 0 1 BIT_MASK 0x1 READ_WRITE /begin IF_DATA ASAP1B_ADDRESS KP_BLOB 0x00000000 /end IF_DATA /end MEASUREMENT
/begin MEASUREMENT xVcAesSupM_B_SupMonrLoExe "Low boost pressure monitor entry condition" UBYTE VOID_SCALING 1 0 0 1 BIT_MASK 0x1 READ_WRITE /begin IF_DATA ASAP1B_ADDRESS KP_BLOB 0x00000000 /end IF_DATA /end MEASUREMENT
/begin MEASUREMENT xVcAesSupM_B_SupMonrLoOk "Supercharger monitor low boost OK" UBYTE VOID_SCALING 1 0 0 1 BIT_MASK 0x1 READ_WRITE /begin IF_DATA ASAP1B_ADDRESS KP_BLOB 0x00000000 /end IF_DATA /end MEASUREMENT
/begin MEASUREMENT xVcAesSupM_B_SupMonrLoSCTarDrvEna "Supercharger target pressure derivative enable condition, supercharger low boost" UBYTE VOID_SCALING 1 0 0 1 BIT_MASK 0x1 READ_WRITE /begin IF_DATA ASAP1B_ADDRESS KP_BLOB 0x00000000 /end IF_DATA /end MEASUREMENT
/begin MEASUREMENT xVcAesSupM_B_SupMonrLoSCTempEna "Supercharger inlet temperature enable condition, supercharger low boost" UBYTE VOID_SCALING 1 0 0 1 BIT_MASK 0x1 READ_WRITE /begin IF_DATA ASAP1B_ADDRESS KP_BLOB 0x00000000 /end IF_DATA /end MEASUREMENT
/begin MEASUREMENT xVcAesSupM_B_SupMonrLoStabEna "Delayed trajectory pressure stable entry condition" UBYTE VOID_SCALING 1 0 0 1 BIT_MASK 0x1 READ_WRITE /begin IF_DATA ASAP1B_ADDRESS KP_BLOB 0x00000000 /end IF_DATA /end MEASUREMENT
/begin MEASUREMENT xVcAesSupM_B_SupMonrLoTarEna "Supercharger target pressure derivative enable condition, supercharger low boost" UBYTE EQ_LSB_1_e 1 0 0 1 BIT_MASK 0x1 READ_WRITE /begin IF_DATA ASAP1B_ADDRESS KP_BLOB 0x00000000 /end IF_DATA /end MEASUREMENT
/begin MEASUREMENT xVcAesSupM_B_SupMonrLoTarMaxEna "Supercharger target pressure enable condition, supercharger low boost" UBYTE EQ_LSB_1_e 1 0 0 1 BIT_MASK 0x1 READ_WRITE /begin IF_DATA ASAP1B_ADDRESS KP_BLOB 0x00000000 /end IF_DATA /end MEASUREMENT
/begin MEASUREMENT xVcAesSupM_B_SupMonrLoTarMinEna "Supercharger target pressure enable condition, supercharger low boost" UBYTE EQ_LSB_1_e 1 0 0 1 BIT_MASK 0x1 READ_WRITE /begin IF_DATA ASAP1B_ADDRESS KP_BLOB 0x00000000 /end IF_DATA /end MEASUREMENT
/begin MEASUREMENT xVcAesSupM_B_SupMonrLoThrDrvEna "Supercharger bypass throttle derivative enable condition, supercharger low boost" UBYTE VOID_SCALING 1 0 0 1 BIT_MASK 0x1 READ_WRITE /begin IF_DATA ASAP1B_ADDRESS KP_BLOB 0x00000000 /end IF_DATA /end MEASUREMENT
/begin MEASUREMENT xVcAesSupM_B_SupMonrLoTstValCmplt "Supercharger low boost pressure monitor test value (average calculation) complete" UBYTE VOID_SCALING 1 0 0 1 BIT_MASK 0x1 READ_WRITE /begin IF_DATA ASAP1B_ADDRESS KP_BLOB 0x00000000 /end IF_DATA /end MEASUREMENT
/begin MEASUREMENT yVcAesSupM_B_SupChrgrErr "Supercharger Peak Pressure engine protection activation flag" UBYTE EQ_LSB_1_j 1 0 0 1 BIT_MASK 0x1 READ_WRITE /begin IF_DATA ASAP1B_ADDRESS KP_BLOB 0x00000000 /end IF_DATA /end MEASUREMENT
/begin COMPU_METHOD EQ_LSB_0_000244140625 "" RAT_FUNC "%15.12" "g/rev" COEFFS 0 1 0 0 0 0.000244140625 /end COMPU_METHOD
/begin COMPU_METHOD EQ_LSB_0_00390625 "" RAT_FUNC "%12.8" "kPa" COEFFS 0 1 0 0 0 0.00390625 /end COMPU_METHOD
/begin COMPU_METHOD EQ_LSB_0_03125 "" RAT_FUNC "%10.5" "K" COEFFS 0 1 0 0 0 0.03125 /end COMPU_METHOD
/begin COMPU_METHOD EQ_LSB_0_25 "" RAT_FUNC "%8.2" "rpm" COEFFS 0 1 0 0 0 0.25 /end COMPU_METHOD
/begin COMPU_METHOD EQ_LSB_1 "" RAT_FUNC "%12.6" "kPa" COEFFS 0 1 0 0 0 1 /end COMPU_METHOD
/begin COMPU_METHOD EQ_LSB_1_a "" RAT_FUNC "%12.6" "K" COEFFS 0 1 0 0 0 1 /end COMPU_METHOD
/begin COMPU_METHOD EQ_LSB_1_b "" RAT_FUNC "%12.6" "rpm" COEFFS 0 1 0 0 0 1 /end COMPU_METHOD
/begin COMPU_METHOD EQ_LSB_1_c "" RAT_FUNC "%12.6" "s" COEFFS 0 1 0 0 0 1 /end COMPU_METHOD
/begin COMPU_METHOD EQ_LSB_1_d "" RAT_FUNC "%12.6" "kPa/s" COEFFS 0 1 0 0 0 1 /end COMPU_METHOD
/begin COMPU_METHOD EQ_LSB_1_e "" RAT_FUNC "%1.0" "-" COEFFS 0 1 0 0 0 1 /end COMPU_METHOD
/begin COMPU_METHOD EQ_LSB_1_g "" RAT_FUNC "%12.6" "g/rev" COEFFS 0 1 0 0 0 1 /end COMPU_METHOD
/begin COMPU_METHOD EQ_LSB_1_h "" RAT_FUNC "%12.6" "-" COEFFS 0 1 0 0 0 1 /end COMPU_METHOD
/begin COMPU_METHOD EQ_LSB_1_j "" RAT_FUNC "%1.0" "%" COEFFS 0 1 0 0 0 1 /end COMPU_METHOD
/begin COMPU_METHOD EQ_LSB_1_k "" RAT_FUNC "%12.6" "%" COEFFS 0 1 0 0 0 1 /end COMPU_METHOD
/begin COMPU_METHOD EQ_LSB_1_l "" RAT_FUNC "%12.6" "%/s" COEFFS 0 1 0 0 0 1 /end COMPU_METHOD
/begin COMPU_METHOD EQ_LSB_6_103515625em05 "" RAT_FUNC "%16.14" "-" COEFFS 0 1 0 0 0 6.103515625e-05 /end COMPU_METHOD
/begin COMPU_METHOD VOID_SCALING "Void scaling for unscaled variables" RAT_FUNC "%1.0" "" COEFFS 0 1 0 0 0 1 /end COMPU_METHOD
/begin COMPU_METHOD VOID_SCALING_f "Void scaling for unscaled variables" RAT_FUNC "%12.6" "" COEFFS 0 1 0 0 0 1 /end COMPU_METHOD
/begin FUNCTION SAesSupM__g29_Avg1 "" /begin DEF_CHARACTERISTIC cVcAesSupM_t_SupMonrHiAvgTi /end DEF_CHARACTERISTIC
 /begin LOC_MEASUREMENT rVcAesSupM_p_SupMonrPDif xVcAesSupM_B_SupMonrHiExe rVcAesSupM_p_SupMonrHiTstVal xVcAesSupM_B_SupMonrHiTstValCmplt /end LOC_MEASUREMENT
 /begin SUB_FUNCTION SAesSupM__g32_Subsystem SAesSupM__g31_EnabledSubsystem /end SUB_FUNCTION
/end FUNCTION
/begin FUNCTION SAesSupM__g30_Avg2 "" /begin DEF_CHARACTERISTIC cVcAesSupM_t_SupMonrLoAvgTi /end DEF_CHARACTERISTIC
 /begin LOC_MEASUREMENT rVcAesSupM_p_SupMonrPDif xVcAesSupM_B_SupMonrLoExe rVcAesSupM_p_SupMonrLoTstVal xVcAesSupM_B_SupMonrLoTstValCmplt /end LOC_MEASUREMENT
 /begin SUB_FUNCTION SAesSupM__g34_Subsystem SAesSupM__g33_EnabledSubsystem /end SUB_FUNCTION
/end FUNCTION
/begin FUNCTION SAesSupM__g31_EnabledSubsystem "" /begin LOC_MEASUREMENT rVcAesSupM_p_SupMonrHiTstVal /end LOC_MEASUREMENT /end FUNCTION
/begin FUNCTION SAesSupM__g32_Subsystem "" /begin DEF_CHARACTERISTIC cVcAesSupM_t_SupMonrHiAvgTi /end DEF_CHARACTERISTIC /begin LOC_MEASUREMENT rVcAesSupM_p_SupMonrPDif /end LOC_MEASUREMENT /end FUNCTION
/begin FUNCTION SAesSupM__g33_EnabledSubsystem "" /begin LOC_MEASUREMENT rVcAesSupM_p_SupMonrLoTstVal /end LOC_MEASUREMENT /end FUNCTION
/begin FUNCTION SAesSupM__g34_Subsystem "" /begin DEF_CHARACTERISTIC cVcAesSupM_t_SupMonrLoAvgTi /end DEF_CHARACTERISTIC /begin LOC_MEASUREMENT rVcAesSupM_p_SupMonrPDif /end LOC_MEASUREMENT /end FUNCTION
/begin FUNCTION SAesSupM__g35_141_CoreHiBoost ""
 /begin DEF_CHARACTERISTIC tVcAesSupM_p_SupMonrHiErrLim tVcAesSupM_p_SupMonrHiErrLim_x /end DEF_CHARACTERISTIC
 /begin LOC_MEASUREMENT rVcAesSupM_p_SupMonrHiTstVal rVcAesSupM_Z_SupMonrHiBoostRnkVal xVcAesSupM_B_SupMonrHiOk xVcAesSupM_B_SupMonrHiErr /end LOC_MEASUREMENT
 /begin SUB_FUNCTION SAesSupM__g41___rtional_Ranking /end SUB_FUNCTION
/end FUNCTION
/begin FUNCTION SAesSupM__g36_142_CoreLoBoost ""
 /begin DEF_CHARACTERISTIC tVcAesSupM_p_SupMonrLoErrLim tVcAesSupM_p_SupMonrLoErrLim_x /end DEF_CHARACTERISTIC
 /begin LOC_MEASUREMENT rVcAesSupM_p_SupMonrLoTstVal rVcAesSupM_Z_SupMonrLoBoostRnkVal xVcAesSupM_B_SupMonrLoOk xVcAesSupM_B_SupMonrLoErr /end LOC_MEASUREMENT
 /begin SUB_FUNCTION SAesSupM__g50___rtional_Ranking /end SUB_FUNCTION
/end FUNCTION
/begin FUNCTION SAesSupM__g41___rtional_Ranking "" /begin LOC_MEASUREMENT rVcAesSupM_p_SupMonrHiTstVal xVcAesSupM_B_SupMonrHiErr /end LOC_MEASUREMENT /begin SUB_FUNCTION SAesSupM__g44_FaultFree SAesSupM__g45_WithFault /end SUB_FUNCTION /end FUNCTION
/begin FUNCTION SAesSupM__g44_FaultFree "" /begin LOC_MEASUREMENT rVcAesSupM_p_SupMonrHiTstVal /end LOC_MEASUREMENT /end FUNCTION
/begin FUNCTION SAesSupM__g45_WithFault "" /begin LOC_MEASUREMENT rVcAesSupM_p_SupMonrHiTstVal /end LOC_MEASUREMENT /end FUNCTION
/begin FUNCTION SAesSupM__g5_11_SupChrgrSys ""
 /begin DEF_CHARACTERISTIC tVcAesSupM_t_SupMonrLoEnaDly tVcAesSupM_t_SupMonrLoEnaDly_x tVcAesSupM_t_SupMonrHiEnaDly tVcAesSupM_t_SupMonrHiEnaDly_x tVcAesSupM_tc_SupMonrSCTarDly tVcAesSupM_tc_SupMonrSCTarDly_x cVcAesSupM_B_SupMonrHiBypFiMPerm cVcAesSupM_B_dcl_mimic cVcAesSupM_B_SupMonrHiCluOnSw cVcAesSupM_B_SupMonrLoBypFiMPerm cVcAesSupM_B_SupMonrLoCluOnSw cVcAesSupM_Te_SupMonrHiTempMin cVcAesSupM_Te_SupMonrLoTempMin cVcAesSupM_X_SupMonrHiCmprThrMaxLim cVcAesSupM_X_SupMonrHiThrNegDrv cVcAesSupM_X_SupMonrHiThrPosDrv cVcAesSupM_X_SupMonrLoThrMaxLim cVcAesSupM_X_SupMonrLoThrMinLim cVcAesSupM_X_SupMonrLoThrNegDrv cVcAesSupM_X_SupMonrLoThrPosDrv cVcAesSupM_dp_SupMonrHiSCTarNegDrv cVcAesSupM_dp_SupMonrHiSCTarPosDrv cVcAesSupM_dp_SupMonrLoSCTarNegDrv cVcAesSupM_dp_SupMonrLoSCTarPosDrv cVcAesSupM_m_SupMonrHiCylRevTotMax cVcAesSupM_m_SupMonrHiCylRevTotMin cVcAesSupM_m_SupMonrLoCylRevTotMax cVcAesSupM_m_SupMonrLoCylRevTotMin cVcAesSupM_n_SupMonrHiEngSpdMax cVcAesSupM_n_SupMonrHiEngSpdMin cVcAesSupM_n_SupMonrLoEngSpdMax cVcAesSupM_n_SupMonrLoEngSpdMin cVcAesSupM_p_SupMonrHiAmbpMin cVcAesSupM_p_SupMonrHiTarMin cVcAesSupM_p_SupMonrLoAmbpMin cVcAesSupM_p_SupMonrLoTarMax cVcAesSupM_p_SupMonrLoTarMin cVcAesSupM_tc_SupMonrHiSCTar cVcAesSupM_tc_SupMonrHiTiConCmprThr cVcAesSupM_tc_SupMonrLoSCTar cVcAesSupM_tc_SupMonrLoTiConCmprThr cVcAesSupM_t_SupMonrHiAvgTi cVcAesSupM_t_SupMonrLoAvgTi /end DEF_CHARACTERISTIC
 /begin LOC_MEASUREMENT rVcAesSupM_p_SupMonrSCTarDly rVcAesSupM_p_SupMonrPDif rVcAesSupM_Z_SupMonrHiSCThrDrv rVcAesSupM_Z_SupMonrLoSCThrDrv rVcAesSupM_Z_SupMonrHiSCTarDrv rVcAesSupM_Z_SupMonrLoSCTarDrv xVcAesSupM_B_SupMonrLoEna xVcAesSupM_B_SupMonrHiCluOnEna xVcAesSupM_B_SupMonrLoExe xVcAesSupM_B_SupMonrLoCluOnEna xVcAesSupM_B_SupMonrLoThrDrvEna xVcAesSupM_B_SupMonrHiThrDrvEna xVcAesSupM_B_SupMonrHiSCTarDrvEna xVcAesSupM_B_SupMonrLoSCTarDrvEna xVcAesSupM_B_SupMonrLoTarEna xVcAesSupM_B_SupMonrLoCmprThrEna xVcAesSupM_B_SupMonrHiCylRevEna xVcAesSupM_B_SupMonrHiExe xVcAesSupM_B_SupMonrLoCylRevEna xVcAesSupM_B_SupMonrHiEngSpdEna xVcAesSupM_B_SupMonrHiEna xVcAesSupM_B_SupMonrLoEngSpdEna xVcAesSupM_B_SupMonrHiAmbpEna xVcAesSupM_B_SupMonrHiTarEna xVcAesSupM_B_SupMonrLoAmbpEna xVcAesSupM_B_SupMonrLoTarMaxEna xVcAesSupM_B_SupMonrHiSCTempEna xVcAesSupM_B_SupMonrLoSCTempEna xVcAesSupM_B_SupMonrLoTarMinEna xVcAesSupM_B_SupMonrLoCmprThrMinEna xVcAesSupM_B_SupMonrLoCmprThrMaxEna xVcAesSupM_B_SupMonrHiCmprThrEna xVcAesSupM_B_SupMonrHiStabEna xVcAesSupM_B_SupMonrLoStabEna rVcAesSupM_p_SupMonrSCTar rVcAesSupM_p_SupMonrHiTstVal xVcAesSupM_B_SupMonrHiTstValCmplt rVcAesSupM_p_SupMonrLoTstVal xVcAesSupM_B_SupMonrLoTstValCmplt /end LOC_MEASUREMENT
 /begin SUB_FUNCTION SAesSupM__g36_142_CoreLoBoost SAesSupM__g35_141_CoreHiBoost SAesSupM__g29_Avg1 SAesSupM__g30_Avg2 /end SUB_FUNCTION
/end FUNCTION
/begin FUNCTION SAesSupM__g50___rtional_Ranking "" /begin LOC_MEASUREMENT rVcAesSupM_p_SupMonrLoTstVal xVcAesSupM_B_SupMonrLoErr /end LOC_MEASUREMENT /begin SUB_FUNCTION SAesSupM__g53_FaultFree SAesSupM__g54_WithFault /end SUB_FUNCTION /end FUNCTION
/begin FUNCTION SAesSupM__g53_FaultFree "" /begin LOC_MEASUREMENT rVcAesSupM_p_SupMonrLoTstVal /end LOC_MEASUREMENT /end FUNCTION
/begin FUNCTION SAesSupM__g54_WithFault "" /begin LOC_MEASUREMENT rVcAesSupM_p_SupMonrLoTstVal /end LOC_MEASUREMENT /end FUNCTION
/begin FUNCTION SAesSupM__g55_21_SupChrgrPPeak "" /begin LOC_MEASUREMENT xVcAesSupM_B_SupChrgrPPeakErr /end LOC_MEASUREMENT /begin SUB_FUNCTION SAesSupM__g59_211_PPeakTest /end SUB_FUNCTION /end FUNCTION
/begin FUNCTION SAesSupM__g56_22_SupChrgrStuck "" /begin LOC_MEASUREMENT xVcAesSupM_B_SupChrgrStuckErr /end LOC_MEASUREMENT /begin SUB_FUNCTION SAesSupM__g70_221_StuckTest /end SUB_FUNCTION /end FUNCTION
/begin FUNCTION SAesSupM__g59_211_PPeakTest ""
 /begin DEF_CHARACTERISTIC tVcAesSupM_p_SupChrgrPPeakLim tVcAesSupM_p_SupChrgrPPeakLim_x cVcAesSupM_p_SupChrgrPPeakHealLim cVcAesSupM_t_SupChrgrPPeakErrDly cVcAesSupM_t_SupChrgrPPeakHealDly /end DEF_CHARACTERISTIC
 /begin LOC_MEASUREMENT xVcAesSupM_B_SupChrgrPPeakErr rVcAesSupM_p_SupChrgrPDsAtmDiff /end LOC_MEASUREMENT
/end FUNCTION
/begin FUNCTION SAesSupM__g70_221_StuckTest ""
 /begin DEF_CHARACTERISTIC mVcAesSupM_m_SupChrgrStuckMaxLoadLim mVcAesSupM_m_SupChrgrStuckMaxLoadLim_r mVcAesSupM_m_SupChrgrStuckMaxLoadLim_c tVcAesSupM_fac_SupChrgrStuckMaxLoadCmp tVcAesSupM_fac_SupChrgrStuckMaxLoadCmp_x cVcAesSupM_X_SupChrgrStuckThrPosRefLim cVcAesSupM_t_SupChrgrStuckRefResetDly cVcAesSupM_X_SupChrgrStuckThrPosMaxLim cVcAesSupM_p_SupChrgrStuckErrLim cVcAesSupM_t_SupChrgrStuckErrDly cVcAesSupM_t_SupChrgrStuckHealDly /end DEF_CHARACTERISTIC
 /begin LOC_MEASUREMENT xVcAesSupM_B_SupChrgrStuckEnable rVcAesSupM_p_SupChgrStuckPDiff xVcAesSupM_B_SupChrgrStuckExe xVcAesSupM_B_SupChrgrStuckUnfiltErr rVcAesSupM_p_SupChrgrStuckPDiffMax rVcAesSupM_m_SupChrgrStuckMaxLoadLim xVcAesSupM_B_SupChrgrStuckErr rVcAesSupM_fac_SupChrgrStuckMaxLoadCmp rVcAesSupM_m_SupChrgrStuckMaxLoadLimBase /end LOC_MEASUREMENT
/end FUNCTION
/begin FUNCTION test_mrg "" /begin OUT_MEASUREMENT yVcAesSupM_B_SupChrgrErr /end OUT_MEASUREMENT
 /begin SUB_FUNCTION SAesSupM__g56_22_SupChrgrStuck SAesSupM__g55_21_SupChrgrPPeak SAesSupM__g5_11_SupChrgrSys /end SUB_FUNCTION
/end FUNCTION
/begin RECORD_LAYOUT FLOAT32_IEEE_COL_DIRECT FNC_VALUES 1 FLOAT32_IEEE COLUMN_DIR DIRECT /end RECORD_LAYOUT
/begin RECORD_LAYOUT FLOAT32_IEEE_X_INCR_DIRECT AXIS_PTS_X 1 FLOAT32_IEEE INDEX_INCR DIRECT /end RECORD_LAYOUT
/begin RECORD_LAYOUT UBYTE_COL_DIRECT FNC_VALUES 1 UBYTE COLUMN_DIR DIRECT /end RECORD_LAYOUT
/begin RECORD_LAYOUT UWORD_COL_DIRECT FNC_VALUES 1 UWORD COLUMN_DIR DIRECT /end RECORD_LAYOUT
/begin RECORD_LAYOUT UWORD_X_INCR_DIRECT AXIS_PTS_X 1 UWORD INDEX_INCR DIRECT /end RECORD_LAYOUT
